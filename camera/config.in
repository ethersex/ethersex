## core/config.in
```kconfig
mainmenu_option next_comment
	comment "Periodic / Scheduler"

	comment "Periodic"
	int_min_max_step 'Periodic ticks per second' CONF_MTICKS_PER_SEC 50 50 20000 50
	MCU_HAS_TIMER_3_SUPPORT=$(mcu_has_timer_3_support)
	dep_bool "Periodic use Timer/Counter 3" PERIODIC_TIMER3_SUPPORT $MCU_HAS_TIMER_3_SUPPORT
	if [ "$PERIODIC_TIMER3_SUPPORT" = y ]; then
		define_symbol CONF_PERIODIC_USE_TIMER 3
	else
		define_symbol CONF_PERIODIC_USE_TIMER 1
	fi
	bool "Periodic timer API support" PERIODIC_TIMER_API_SUPPORT
	bool "Periodic adjust support" PERIODIC_ADJUST_SUPPORT

	dep_bool_menu "Periodic general debugging" DEBUG_PERIODIC $DEBUG
		dep_bool "Read periodic debug stats via ECMD" DEBUG_PERIODIC_ECMD_SUPPORT $DEBUG_PERIODIC $ECMD_PARSER_SUPPORT
		dep_bool "Toggle pins in periodic tick" DEBUG_PERIODIC_WAVEFORMS_SUPPORT $DEBUG_PERIODIC
		if [ "$PERIODIC_TIMER3_SUPPORT" = y ]; then
			dep_bool "Enable toggling of Timer/Counter OC1A-Pin" DEBUG_PERIODIC_OC1A_SUPPORT n
		else
			dep_bool "Enable toggling of Timer/Counter OC1A-Pin" DEBUG_PERIODIC_OC1A_SUPPORT $DEBUG_PERIODIC_WAVEFORMS_SUPPORT $DEBUG_PERIODIC
		fi
	endmenu

	source core/scheduler/config.in

endmenu

dep_bool_menu "Status LEDs" STATUSLEDS $ARCH_AVR
	dep_bool "Status LED (Power)"		STATUSLED_POWER_SUPPORT		$STATUSLEDS
	dep_bool "Status LED (Booted)"		STATUSLED_BOOTED_SUPPORT	$STATUSLEDS
	dep_bool "Status LED (Net link)"	STATUSLED_NETLINK_SUPPORT	$STATUSLEDS
	dep_bool "Status LED (Transmitted)"	STATUSLED_TX_SUPPORT		$STATUSLEDS
	dep_bool "   RFM12 TX"			STATUSLED_RFM12_TX_SUPPORT	$STATUSLED_TX_SUPPORT $RFM12_SUPPORT
	dep_bool "   ZBUS TX"			STATUSLED_ZBUS_TX_SUPPORT	$STATUSLED_TX_SUPPORT $ZBUS_SUPPORT
	dep_bool "   IRMP TX"			STATUSLED_IRMP_TX_SUPPORT	$STATUSLED_TX_SUPPORT $IRMP_TX_SUPPORT
	dep_bool "   EMS TX"			STATUSLED_EMS_TX_SUPPORT	$STATUSLED_TX_SUPPORT $EMS_SUPPORT
	dep_bool "Status LED (Received)"	STATUSLED_RX_SUPPORT		$STATUSLEDS
	dep_bool "   RFM12 RX"			STATUSLED_RFM12_RX_SUPPORT	$STATUSLED_RX_SUPPORT $RFM12_SUPPORT
	dep_bool "   ZBUS RX"			STATUSLED_ZBUS_RX_SUPPORT	$STATUSLED_RX_SUPPORT $ZBUS_SUPPORT
	dep_bool "   IRMP RX"			STATUSLED_IRMP_RX_SUPPORT	$STATUSLED_RX_SUPPORT $IRMP_RX_SUPPORT
	dep_bool "   EMS RX OK"			STATUSLED_EMS_RX_OK_SUPPORT	$STATUSLED_RX_SUPPORT $EMS_SUPPORT
	dep_bool "Status LED (Error)"		STATUSLED_ERROR_SUPPORT		$STATUSLEDS
	dep_bool "   EMS RX Failure"		STATUSLED_EMS_RX_FAIL_SUPPORT	$STATUSLED_ERROR_SUPPORT $EMS_SUPPORT
	dep_bool "Heartbeat / Activity LED"	STATUSLED_HB_ACT_SUPPORT	$STATUSLEDS
	dep_bool "   Heartbeat"			STATUSLED_HEARTBEAT_SUPPORT	$STATUSLED_HB_ACT_SUPPORT
	dep_bool "   RFM12 TX Activity"		STATUSLED_RFM12_TX_ACT_SUPPORT	$STATUSLED_HB_ACT_SUPPORT $RFM12_SUPPORT
	dep_bool "   RFM12 RX Activity"		STATUSLED_RFM12_RX_ACT_SUPPORT	$STATUSLED_HB_ACT_SUPPORT $RFM12_SUPPORT
	dep_bool "   ZBUS TX Activity"		STATUSLED_ZBUS_TX_ACT_SUPPORT	$STATUSLED_HB_ACT_SUPPORT $ZBUS_SUPPORT
	dep_bool "   ZBUS RX Activity"		STATUSLED_ZBUS_RX_ACT_SUPPORT	$STATUSLED_HB_ACT_SUPPORT $ZBUS_SUPPORT
	dep_bool "   EMS TX Activity"		STATUSLED_EMS_TX_ACT_SUPPORT	$STATUSLED_HB_ACT_SUPPORT $EMS_SUPPORT
	dep_bool "   EMS RX Activity"		STATUSLED_EMS_RX_ACT_SUPPORT	$STATUSLED_HB_ACT_SUPPORT $EMS_SUPPORT
	dep_bool "   ECMD Activity"		STATUSLED_ECMD_ACT_SUPPORT	$STATUSLED_HB_ACT_SUPPORT $ECMD_SUPPORT
endmenu

if [ "$STATUSLED_HEARTBEAT_SUPPORT" = "y" ]; then
	if [ "$BOOTLOADER_SUPPORT" = "y" ]; then
		define_bool STATUSLED_HEARTBEAT_BOOTLOADER_SUPPORT y
	else
		define_bool STATUSLED_HEARTBEAT_STANDARD_SUPPORT y
	fi
fi
```

## core/portio/config.in
```kconfig
copy_example_namedpin
dep_bool "Named and logic state I/O" NAMED_PIN_SUPPORT 
if [ x"$NAMED_PIN_SUPPORT" = x"y" ]; then
	choice '  Named pin configuration'	\
			"$(cd pinning/named_pin/; for i in `ls`; do echo $i $i; done)" \
		'default' _NP_CONFIG
	define_symbol NP_CONFIG "pinning/named_pin/$_NP_CONFIG"
	editor "Edit Named pin configuration" NP_CONFIG_EDIT "pinning/named_pin/$_NP_CONFIG"
fi
```

## hardware/adc/config.in
```kconfig
if [ "$TEENSY_SUPPORT" = "y" ]; then
	dep_bool_menu "ADC light input" ADC_LIGHT $ARCH_AVR
		if [ "$KTY_SUPPORT" = "y" ]; then
			define_symbol ADC_REF ADC_AREF
		else
			choice 'ADC Reference'		\
				"ARef		CONFIG_ADC_AREF		\
				AVcc		CONFIG_ADC_AVCC		\
				Internal_1.1V	CONFIG_ADC_1_1		\
				Internal_2.56V	CONFIG_ADC_2_56"	\
			'ARef'
			if [ "$CONFIG_ADC_AREF" = "y" ]; then
				define_symbol ADC_REF ADC_AREF
			elif [ "$CONFIG_ADC_AVCC" = "y" ]; then
				define_symbol ADC_REF ADC_AVCC
			elif [ "$CONFIG_ADC_1_1" = "y" ]; then
				define_symbol ADC_REF ADC_1_1
			else
				define_symbol ADC_REF ADC_2_56
			fi
			dep_bool "HR20-style Temperature Sensor" HR20_TEMP_SUPPORT $CONFIG_ADC_AVCC
		fi
	endmenu
else
	dep_bool_menu "ADC input" ADC_SUPPORT $ARCH_AVR
		if [ "$KTY_SUPPORT" = "y" ]; then
				define_symbol ADC_REF ADC_AREF
		else
			choice 'ADC Reference'		\
				"ARef		CONFIG_ADC_AREF		\
				AVcc		CONFIG_ADC_AVCC		\
				Internal_1.1V	CONFIG_ADC_1_1		\
				Internal_2.56V	CONFIG_ADC_2_56"	\
			'ARef'
			if [ "$CONFIG_ADC_AREF" = "y" ]; then
				define_symbol ADC_REF ADC_AREF
			elif [ "$CONFIG_ADC_AVCC" = "y" ]; then
				define_symbol ADC_REF ADC_AVCC
			elif [ "$CONFIG_ADC_1_1" = "y" ]; then
				define_symbol ADC_REF ADC_1_1
			else
				define_symbol ADC_REF ADC_2_56
			fi
			dep_bool "HR20-style Temperature Sensor" HR20_TEMP_SUPPORT $CONFIG_ADC_AVCC
			dep_bool "ADC voltage support" ADC_VOLTAGE_SUPPORT $ADC_SUPPORT
		fi
	endmenu
fi

if [ "$KTY_SUPPORT" = "y" -o "$HR20_TEMP_ECMD_SUPPORT" = "y"  -o "$ONEWIRE_SUPPORT" = "y" ]; then
	define_bool	NEED_TEMP2TEXT	y
else
	define_bool	NEED_TEMP2TEXT	n
fi
```

## hardware/adc/kty/config.in
```kconfig
  dep_bool  "KTY Calculation Support" KTY_SUPPORT $ADC_SUPPORT $ARCH_AVR
  if [ "$KTY_SUPPORT" = "y" ]; then
    choice '  KTY81 Device' "KTY81-110 KTY_DEVICE_110" 'KTY81-110' KTY_DEVICE
  fi
```

## hardware/camera/config.in
```kconfig
dep_bool_menu "Camera support" CAMERA_SUPPORT $ARCH_AVR
	usart_count_used
	if [ "$DC3840_SUPPORT" = y -o $USARTS -gt $USARTS_USED ]; then
  dep_bool_menu "DC3840 Serial camera" DC3840_SUPPORT $CAMERA_SUPPORT
    choice "DC3840 resolution"		\
    	"80x64		CONFIG_DC3840_RES80	\
	 160x128	CONFIG_DC3840_RES160	\
	 320x240	CONFIG_DC3840_RES320	\
	 640x480	CONFIG_DC3840_RES640"	\
      '160x120'

    if [ "$CONFIG_DC3840_RES80" = "y" ]; then
      define_int DC3840_RESOLUTION 1
    elif [ "$CONFIG_DC3840_RES160" = "y" ]; then
      define_int DC3840_RESOLUTION 3
    elif [ "$CONFIG_DC3840_RES320" = "y" ]; then
      define_int DC3840_RESOLUTION 5
    elif [ "$CONFIG_DC3840_RES640" = "y" ]; then
      define_int DC3840_RESOLUTION 7
    fi

    bool "Use high compression" DC3840_HIGH_COMPRESSION
    bool "Black/White mode" DC3840_BLACK_WHITE

    usart_count_used
    comment "Usart Configuration ($USARTS_USED/$USARTS)"
    choice 'DC3840 USART' "$(usart_choice DC3840)"
    usart_process_choice DC3840

	comment  "Debugging Flags"
	dep_bool 'DC3840 UDP Debug' DC3840_UDP_DEBUG $DEBUG $DC3840_SUPPORT
    if [ "$DC3840_UDP_DEBUG" = "y" ]; then
	  int "DC3840 Port" DC3840_PORT 7676
    fi
  endmenu
	else
		define_bool DC3840_SUPPORT n
		comment "DC3840 Serial camera not available. No free usart. ($USARTS_USED/$USARTS)"
	fi

endmenu
```

## hardware/clock/dcf77/config.in
```kconfig
DCFENABLE="n"
if [ "$CLOCK_CRYSTAL_SUPPORT" = "y" -o "$CLOCK_PERIODIC_SUPPORT" = "y" ]; then
  DCFENABLE="y"
fi
dep_bool_menu "Synchronize using DCF77 signal" DCF77_SUPPORT $ARCH_AVR $DCFENABLE
  if [ "$DCF77_SUPPORT" = "y" ]; then
    choice 'Module'		\
	"SelfMade	DCFANA	\
	 DCF_1		DCF1"	\
 	"SelfMade" DCF77_MODULE
  fi
  if [ "$DCF77_MODULE" = "DCFANA" ]; then
    define_bool DCFANA_SUPPORT y
  fi
  if [ "$DCF77_MODULE" = "DCF1" ]; then
    define_bool DCF1_SUPPORT y
    dep_bool "Use PON" DCF1_USE_PON_SUPPORT
  fi
  comment  "Debugging Flags"
  dep_bool 'DCF77' DEBUG_DCF77 $DEBUG
endmenu
```

## hardware/config.in
```kconfig
source hardware/io_expander/config.in
source hardware/sms/config.in

mainmenu_option next_comment

  comment "ADC / DAC"

  source hardware/adc/config.in
  source hardware/adc/kty/config.in
  source hardware/adc/ads7822/config.in
  source hardware/dac/config.in

endmenu

source hardware/lcd/config.in
source hardware/storage/config.in
source hardware/i2c/config.in
source hardware/camera/config.in
source hardware/radio/config.in
source hardware/ir/config.in
source hardware/isdn/config.in
source hardware/pwm/config.in
source hardware/onewire/config.in
source hardware/input/config.in
source hardware/input/ps2/config.in
source hardware/input/buttons/config.in

mainmenu_option next_comment

  comment "Humidity & temperature sensors"

  source hardware/sht/config.in
  source hardware/dht/config.in
  source hardware/zacwire/config.in

endmenu

source hardware/ultrasonic/config.in
source hardware/hbridge/config.in
```

## hardware/dht/config.in
```kconfig
dep_bool_menu "DHT 11/22" DHT_SUPPORT $ARCH_AVR
  if [ "$DHT_SUPPORT" = "y" ]; then
     choice 'Sensor type'                 \
            "DHT11          DHT_TYPE_11   \
             DHT22/AM2302   DHT_TYPE_22"  \
            'DHT11'         DHT_TYPE
     int "Time between polling in 1s steps" DHT_POLLING_INTERVAL 30
     editor "Edit pin configuration" $DHT_TYPE "hardware/dht/dht_pinning.conf"
     dep_bool "SNMP support" DHT_SNMP_SUPPORT $SNMP_SUPPORT

     comment "ECMD Support"
     dep_bool "temp"              DHT_TEMP_ECMD_SUPPORT $ECMD_PARSER_SUPPORT
     dep_bool "humid"             DHT_HUMID_ECMD_SUPPORT $ECMD_PARSER_SUPPORT
     dep_bool "list"              DHT_LIST_ECMD_SUPPORT $ECMD_PARSER_SUPPORT
     dep_bool "list with values"  DHT_LIST_WITH_VALUES_CMD_SUPPORT $DHT_LIST_ECMD_SUPPORT $ECMD_PARSER_SUPPORT

     comment "Debugging Flags"
     dep_bool "DHT" DEBUG_DHT $DEBUG $DHT_SUPPORT
  fi
endmenu
```
