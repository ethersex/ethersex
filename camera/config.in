## camera/config.in
```kconfig
dep_bool_menu "Camera support" CAMERA_SUPPORT

  dep_bool_menu "DC3840 Serial camera" DC3840_SUPPORT $CAMERA_SUPPORT
    choice "DC3840 resolution"		\
    	"160x120	CONFIG_DC3840_RES160	\
	 320x240	CONFIG_DC3840_RES320	\
	 640x480	CONFIG_DC3840_RES640"	\
      '160x120'

    if [ "$CONFIG_DC3840_RES160" = "y" ]; then
      define_int DC3840_RESOLUTION 0x1913
    elif [ "$CONFIG_DC3840_RES320" = "y" ]; then
      define_int DC3840_RESOLUTION 0x0905
    elif [ "$CONFIG_DC3840_RES640" = "y" ]; then
      define_int DC3840_RESOLUTION 0x0907
    fi

    usart_count_used
    comment "Usart Configuration ($USARTS_USED/$USARTS)"
    choice 'DC3840 USART' "$(usart_choice DC3840)"
    usart_process_choice DC3840

  endmenu

endmenu
```

## clock/config.in
```kconfig
mainmenu_option next_comment
comment "System clock"
  bool "System clock support" CLOCK_SUPPORT
  dep_bool "Use 32 kHz crystal to tick the clock" CLOCK_CRYSTAL_SUPPORT $CLOCK_SUPPORT
  dep_bool "Synchronize using DCF77 signal" DCF77_SUPPORT $CLOCK_CRYSTAL_SUPPORT
  dep_bool "Synchronize using NTP protocol" NTP_SUPPORT $CLOCK_SUPPORT $UDP_SUPPORT
  dep_bool "Cron daemon" CRON_SUPPORT $CLOCK_SUPPORT
  dep_bool "NTP daemon" NTPD_SUPPORT $CLOCK_SUPPORT $UDP_SUPPORT
  dep_bool "Working hour meter" WHM_SUPPORT $CLOCK_SUPPORT
  if [ "$CLOCK_SUPPORT" = "y" ]; then
    choice 'Time Zone'					\
	"UTC			TIMEZONE_UTC	\
	 CET/CEST		TIMEZONE_CEST"	\
	 UTC
  fi 
endmenu
```

## config.in
```kconfig
source scripts/usart-config.sh
source scripts/rfm12-config.sh
source scripts/namedPinCopy.sh
source scripts/avrdude_config.sh
mainmenu_name "Ethersex Configuration"
get_usart_count


mainmenu_option next_comment
comment "General Setup"
	get_usart_count

	choice 'Target Architecture'			\
		"AVR		ARCH_AVR		\
		 Host		ARCH_HOST"		\
		'AVR' ARCH

if [ "$ARCH_AVR" = "y" ]; then
	choice 'Target MCU'			\
		"ATmega8      atmega8		\
		 ATmega88     atmega88		\
		 ATmega128    atmega128		\
		 ATmega16     atmega16		\
		 ATmega162    atmega162		\
		 ATmega168    atmega168		\
		 ATmega168p   atmega168p	\
		 ATmega169    atmega169		\
		 ATmega32     atmega32		\
		 ATmega328p   atmega328p	\
		 ATmega64     atmega64		\
		 ATmega644    atmega644		\
		 ATmega644p   atmega644p	\
		 ATmega1284p  atmega1284p	\
		 AT90CAN32    at90can32		\
		 AT90CAN64    at90can64		\
		 AT90CAN128   at90can128"	\
		'ATmega644' MCU

	int "MCU frequency" FREQ 20000000

	choice 'Hardware/Periphery Class'	\
			"$(scripts/pinning_hardware_list.sh)" \
		'Etherrape' HARDWARE

	dep_bool "Use CPU sleep" CPU_SLEEP $ARCH_AVR
	source hardware/sram/config.in


	# get the flash size according to the cpu type
	FLASH_SIZE=$((`echo -e "#include <avr/io.h>\nFLASHEND" | avr-cpp -mmcu=$MCU | sed '$!d'` + 1 ))

	# set the default bootloader bytes according to cpu flash size
	if [ "$BOOTLOADER_SIZE" = "" ] ; then
		if [ "$FLASH_SIZE" = 8192 ] ; then BOOTLOADER_SIZE=2048 ; fi
		if [ "$FLASH_SIZE" = 16384 ] ; then BOOTLOADER_SIZE=2048 ; fi
		if [ "$FLASH_SIZE" = 32768 ] ; then BOOTLOADER_SIZE=4096 ; fi
		if [ "$FLASH_SIZE" = 65536 ] ; then BOOTLOADER_SIZE=8192 ; fi
		if [ "$FLASH_SIZE" = 131072 ] ; then BOOTLOADER_SIZE=8192 ; fi
	fi

	dep_bool 'Build a bootloader'     BOOTLOADER_SUPPORT "$(not $BOOTLOADER_JUMP)"  "$(if [ $FLASH_SIZE -gt 65535 ] ; then echo -ne "y"; else echo -ne "n"; fi)"
	dep_bool "Enable bootloader jump" BOOTLOADER_JUMP    "$(not $BOOTLOADER_SUPPORT)"

	if [ "$BOOTLOADER_JUMP" = "y" -o "$BOOTLOADER_SUPPORT" = "y" ] ; then
		int 'Bootloader size in bytes' BOOTLOADER_SIZE ""
	else
		define_int BOOTLOADER_SIZE "$((BOOTLOADER_SIZE))"
	fi

	define_hex BOOTLOADER_START_ADDRESS "$(printf '0x%X\n' $(($FLASH_SIZE - $BOOTLOADER_SIZE)))"

	define_hex FLASH_SIZE "$(printf '0x%X\n' $FLASH_SIZE)"
	define_hex EEPROM_SIZE "$(printf '0x%X\n' $((`echo -e "#include <avr/io.h>\nE2END" | avr-cpp -mmcu=$MCU | sed '$!d'` + 1)))"
	define_hex RAM_SIZE "$(printf '0x%X\n' $((`echo -e "#include <avr/io.h>\nRAMEND" | avr-cpp -mmcu=$MCU | sed '$!d'` + 1)))"
	define_hex FLASH_PAGESIZE "$(printf '0x%X\n' $((`echo -e "#include <avr/io.h>\nSPM_PAGESIZE" | avr-cpp -mmcu=$MCU | sed '$!d'`)))"
	define_hex EEPROM_PAGESIZE "$(printf '0x%X\n' $((`echo -e "#include <avr/io.h>\nE2PAGESIZE" | avr-cpp -mmcu=$MCU | sed '$!d'`)))"

	source core/crc/config.in
fi

	bool "MBR support" MBR_SUPPORT

	bool "Teensy build" TEENSY_SUPPORT

	dep_bool "Use SPI Timeout" SPI_TIMEOUT $ARCH_AVR
	dep_bool "Use Usart in SPI Mode" USART_SPI_SUPPORT $ARCH_AVR
	if [ "$USART_SPI_SUPPORT" = y ]; then
		choice '  SPI usart select' "$(usart_choice SPI)"
		usart_process_choice SPI
	else
		dep_bool "Use Software-SPI" SOFT_SPI_SUPPORT $ARCH_AVR
	fi

	define_string GIT_VERSION "$(scripts/get-git-version)"

	bool 'Debug: Discard some packets' DEBUG_DISCARD_SOME

	# general debug support
	dep_bool_menu "Enable Debugging" DEBUG y
		comment "Debugging output"
		usart_count_used
		debug_output_choices=""
		# enable choice of USART if there is one used by either
		# debug or ecmd or if there is at least one unused USART
		if [ "$DEBUG_SERIAL_USART_SUPPORT" = y \
			-o "$ECMD_SERIAL_USART_SUPPORT" = y \
			-o $USARTS -gt $USARTS_USED ]; then
			debug_output_choices="USART	usart "
			debug_output_default="USART"
		else
			comment "USART (RS232/RS485) not available. No free usart. ($USARTS_USED/$USARTS)"
		fi

		if [ "$ARCH_AVR" = y ]; then
			debug_output_choices+="Software-UART soft_uart "
			test -n "$debug_output_default" || debug_output_default="Software-UART"
		fi

		# to send debug via syslog one has to enable
		# protocols > SYSLOG_SUPPORT first
		if [ "$SYSLOG_SUPPORT" = y ]; then
			debug_output_choices+="SYSLOG syslog "
			test -n "$debug_output_default" || debug_output_default="SYSLOG"
		fi

		if [ "$DEBUG" = y ] && [ -n "$debug_output_choices" ]; then
			choice 'Debug output channel' \
			"$debug_output_choices" \
			"$debug_output_default" DEBUG_OUTPUT
		fi

		case "$DEBUG_OUTPUT" in
			"usart")
				define_bool DEBUG_SERIAL_USART_SUPPORT $DEBUG
				define_bool SOFT_UART_SUPPORT n
				define_bool DEBUG_USE_SYSLOG n
				;;
			"soft_uart")
				define_bool SOFT_UART_SUPPORT $DEBUG $ARCH_AVR
				define_bool DEBUG_SERIAL_USART_SUPPORT n
				define_bool DEBUG_USE_SYSLOG n
				;;
			"syslog")
				define_bool DEBUG_USE_SYSLOG $DEBUG $SYSLOG_SUPPORT
				define_bool DEBUG_SERIAL_USART_SUPPORT n
				define_bool SOFT_UART_SUPPORT n
				;;
			*)
				define_bool DEBUG_USE_SYSLOG $DEBUG n
				define_bool DEBUG_SERIAL_USART_SUPPORT n
				define_bool SOFT_UART_SUPPORT n
				;;
		esac

		if [ "$DEBUG_SERIAL_USART_SUPPORT" = y ]; then
			choice 'Debug USART channel' "$(usart_choice DEBUG)"
			usart_process_choice DEBUG
			# share ECMD baud settings if the USART is shared
			if [ "$ECMD_SERIAL_USART_SUPPORT" = y ] && \
				[ "$DEBUG_USE_USART" = "$ECMD_SERIAL_USART_USE_USART" ] ; then
					define_int DEBUG_BAUDRATE $ECMD_SERIAL_BAUDRATE
					comment "USART Baudrate set to match ECMD setting ($DEBUG_BAUDRATE Baud)."
			else
				int "USART Baudrate" DEBUG_BAUDRATE 115200
			fi
		elif [ "$SOFT_UART_SUPPORT" = y ]; then
			int "Software-UART Baudrate" DEBUG_BAUDRATE 19200
		fi
		comment  'Debugging Flags'
		dep_bool 'Hooks' DEBUG_HOOK $DEBUG
		dep_bool 'Reset Reason' DEBUG_RESET_REASON $DEBUG
	endmenu

	source core/config.in
	source core/crypto/config.in
	source core/vfs/config.in
	source services/pam/config.in
	source control6/config.in
endmenu

mainmenu_option next_comment
	comment "Network"

	string "Hostname" CONF_HOSTNAME "ethersex"


#	if [ "$ENC28J60_SUPPORT" = "y" -o "$RFM12_IP_SUPPORT" = "y" -o "$ZBUS_SUPPORT" = "y" -o "$UIP_SUPPORT" = "y" -o "$UDP_SUPPORT" = "y" -o "$TCP_SUPPORT" = "y" -o "$ICMP_SUPPORT" = "y" ]; then
		if [ "$NET_MAX_FRAME_LENGTH" = "" ] ; then NET_MAX_FRAME_LENGTH=1500 ; fi
		if [ "$NET_MAX_FRAME_LENGTH" -lt 64 -o "$NET_MAX_FRAME_LENGTH" -gt 1500 ] ; then NET_MAX_FRAME_LENGTH=1500 ; fi

		if [ "$atmega8" = "y" -o "$atmega88" = "y" -o "$atmega16" = "y" -o "$atmega168" = "y" -o "$atmega169" = "y" -o "$atmega168p" = "y" ] ; then
			if [ "$NET_MAX_FRAME_LENGTH" -gt 192 ] ; then NET_MAX_FRAME_LENGTH=192 ; fi
		fi
		if [ "$atmega32" = "y" ] ; then
			if [ "$TEENSY_SUPPORT" = "y" ] ; then
				if [ "$NET_MAX_FRAME_LENGTH" -gt 192 ] ; then NET_MAX_FRAME_LENGTH=192 ; fi
			else
				if [ "$NET_MAX_FRAME_LENGTH" -gt 500 ] ; then NET_MAX_FRAME_LENGTH=500 ; fi
			fi
		fi
		if [ "$atmega162" = "y" -a "$NET_MAX_FRAME_LENGTH" -gt 600 ] ; then NET_MAX_FRAME_LENGTH=600 ; fi
		if [ "$atmega328p" = "y" -a "$NET_MAX_FRAME_LENGTH" -gt 384 ] ; then NET_MAX_FRAME_LENGTH=384 ; fi

		Value=$NET_MAX_FRAME_LENGTH

		int "Network Buffer Size" NET_MAX_FRAME_LENGTH $NET_MAX_FRAME_LENGTH
#	fi

	source hardware/ethernet/config.in
	source core/host/tap-config.in
	source hardware/radio/rfm12/config.in
	dep_bool 'RFM12 raw' RFM12_RAW_SUPPORT $RFM12_IP_SUPPORT $ROUTER_SUPPORT $UDP_SUPPORT
	if [ "$RFM12_RAW_SUPPORT" = y ]; then
		int 'RFM12 raw UDP Port' RFM12_RAW_UDP_PORT 16962
	fi
	source protocols/usb/config.in
	source protocols/zbus/config.in
	dep_bool 'ZBUS raw' ZBUS_RAW_SUPPORT $ZBUS_SUPPORT $ROUTER_SUPPORT $UDP_SUPPORT
	source scripts/ip-router-conf.sh

	comment "IP configuration"
	dep_bool 'IPv6 support'		IPV6_SUPPORT $UIP_SUPPORT
	if [ "$IPV6_SUPPORT" = "y" ]; then
		define_bool IPV4_SUPPORT n
	else
		define_bool IPV4_SUPPORT $UIP_SUPPORT
	fi

	dep_bool 'Enable IP forwarding' IP_FORWARDING_SUPPORT $ROUTER_SUPPORT

	dep_bool 'Enable TCP inactivity timeout' UIP_TIMEOUT_SUPPORT $UIP_SUPPORT
	if [ "$UIP_TIMEOUT_SUPPORT" = "y" ]; then
		int "  TCP inactivity timeout (in minutes)" UIP_TIMEOUT_COUNT 10
	fi

        if [ "$IPV6_SUPPORT" != "y" -a "$BOOTP_SUPPORT" != "y" -o "$IPV6_STATIC_SUPPORT" = "y" ]; then
		ip "Default gateway" CONF_ETHERSEX_GATEWAY "192.168.23.1" "2001:6f8:1209:f0:0:0:0:1"
	fi

	define_bool UIP_MULTI_STACK $ROUTER_SUPPORT
	source protocols/uip/ipchair/config.in
	source protocols/uip/config.in
	source protocols/dns/config.in

	if [ "$DHCP_SUPPORT" = "y" ]; then
		dep_bool 'BOOTP (DHCP-like) support' BOOTP_SUPPORT "n"
	else
		dep_bool 'BOOTP (DHCP-like) support' BOOTP_SUPPORT $BROADCAST_SUPPORT $ENC28J60_SUPPORT $IPV4_SUPPORT
	fi
	dep_bool 'Write BOOTP data to EEPROM' BOOTP_TO_EEPROM_SUPPORT $BOOTLOADER_SUPPORT $BOOTP_SUPPORT

	if [ "$BOOTP_SUPPORT" = "y" ]; then
		dep_bool "DHCP support" DHCP_SUPPORT "n"
	else
		dep_bool "DHCP support" DHCP_SUPPORT $BROADCAST_SUPPORT $ENC28J60_SUPPORT $IPV4_SUPPORT
	fi

	comment "Tunneling protocols"
	dep_bool_menu "OpenVPN" OPENVPN_SUPPORT $UDP_SUPPORT
		hex "OpenVPN key" CONF_OPENVPN_KEY "00000000000000000000000000000000"
		hex "OpenVPN HMAC key" CONF_OPENVPN_HMAC_KEY "00000000000000000000000000000000"

		comment "OpenVPN IP configuration"
		ip "OpenVPN IP address" CONF_OPENVPN_IP "192.168.23.244" "2001:6f8:1209:F0:0:0:0:1"
		if [ "$IPV6_SUPPORT" = "y" ]; then
			int "IP prefix length" CONF_OPENVPN_IP6_PREFIX_LEN 64
		else
			ipv4 "OpenVPN netmask" CONF_OPENVPN_IP4_NETMASK "255.255.255.0"
		fi

		comment "OpenVPN Remote"
		dep_bool "Static OpenVPN Remote" OPENVPN_STATIC_REMOTE $OPENVPN_SUPPORT
		if [ "$OPENVPN_STATIC_REMOTE" = "y" ]; then
			ip "Remote IP" CONF_OPENVPN_REMOTE_IP "192.168.23.254" "2001:6f8:1209:f0:230:5ff:fe23:3f8"
		fi
		comment "OpenVPN Port"
		int 'OpenVPN Port' CONF_OPENVPN_PORT 1194
	endmenu

	comment  "Debugging Flags"
	dep_bool 'Networking' DEBUG_NET $DEBUG
	dep_bool '  Config' DEBUG_NET_CONFIG $DEBUG_NET
	dep_bool '  IPv6' DEBUG_NET_IP6 $DEBUG
	dep_bool '  OpenVPN' DEBUG_OPENVPN $DEBUG
	dep_bool '  Router' DEBUG_ROUTER $DEBUG
	dep_bool '  uIP' DEBUG_UIP $DEBUG
	dep_bool '  NTP' DEBUG_NTP $DEBUG
	dep_bool '  Unknown packets' DEBUG_UNKNOWN_PACKETS $DEBUG_NET

endmenu

###############################################################################

mainmenu_option next_comment
comment "I/O"

	if [ "$ARCH_HOST" = "y" ]; then
		define_bool PORTIO_SUPPORT n
		define_bool PORTIO_SIMPLE_SUPPORT n
		define_bool NAMED_PIN_SUPPORT n
	else
		choice "I/O abstraction model (Port I/O)" \
			"None			CONFIG_IO_NONE		\
			 Simple			PORTIO_SIMPLE		\
			 Full-featured		PORTIO_FULL_FEATURED"	\
			Simple PORTIO_SCHEME

		if [ x"$PORTIO_SCHEME" = x"PORTIO_SIMPLE" ]; then
			define_bool PORTIO_SIMPLE_SUPPORT y
			define_bool PORTIO_SUPPORT n
		elif [ x"$PORTIO_SCHEME" = x"PORTIO_FULL_FEATURED" ]; then
			define_bool PORTIO_SIMPLE_SUPPORT n
			define_bool PORTIO_SUPPORT y
		fi

		source core/portio/config.in
	fi

	source core/tty/config.in
	source hardware/config.in
	source mcuf/config.in
endmenu

###############################################################################

source protocols/config.in

###############################################################################

source services/config.in

###############################################################################

if [ "$ZBUS_SUPPORT" = "y"		\
	-o "$YPORT_SUPPORT" = "y"	\
	-o "$MODBUS_SUPPORT" = "y" ]; then
  define_bool USART_SUPPORT y
fi

if [ "$RFM12_IP_SUPPORT" = "y" -o "$RFM12_ASK_SUPPORT" = "y" -o "$RFM12_DISABLE" = "y" ]; then
  define_bool RFM12_SUPPORT y
else
  define_bool RFM12_SUPPORT n
fi

if [ "$UIP_SUPPORT" = "y" -a "$IPV6_SUPPORT" != "y" ]; then
  define_bool IPV4_SUPPORT y
fi

if [ "$HAS_AVRDUDE" = "y" ]; then
  mainmenu_option next_comment
    comment "AVRDUDE configuration"
    source scripts/avrdude_config.in
  endmenu
fi
```
