## services/watchasync/config.in
```kconfig
dep_bool_menu "watchasync service" WATCHASYNC_SUPPORT $TCP_SUPPORT
  string "Server" CONF_WATCHASYNC_SERVER "volkszaehler.org"
  if [ "$DNS_SUPPORT" != "y" ]; then
	ip "Server IP" WATCHASYNC_SERVER_IP "78.46.142.232" "::1"
  fi
  int "Port number" CONF_WATCHASYNC_PORT 80
  string "HTTP Method (often GET or POST)" CONF_WATCHASYNC_METHOD "POST"
  string "Path in front of pin identifier" CONF_WATCHASYNC_PATH "/path/to/volkszaehler/backend.php/data/"
  string "Path at the end" CONF_WATCHASYNC_END_PATH ""
  dep_bool "Include unix timestamp" CONF_WATCHASYNC_TIMESTAMP $CLOCK_DATETIME_SUPPORT
  if [ "$CONF_WATCHASYNC_TIMESTAMP" = "y" ]; then
    string "Path in front of timestamp" CONF_WATCHASYNC_TIMESTAMP_PATH ".json?ts="
    int "Resolution in seconds (Power of 2)" CONF_WATCHASYNC_RESOLUTION 1
    bool "Send end of intervall instead of beginning" CONF_WATCHASYNC_SENDEND
  fi
  dep_bool "Summarize Events" CONF_WATCHASYNC_SUMMARIZE $CLOCK_DATETIME_SUPPORT
  if [ "$CONF_WATCHASYNC_SUMMARIZE" = "y" ]; then
    string "Path in front of eventcount" CONF_WATCHASYNC_SUMMARIZE_PATH "&value="
    choice "Counterrange"					\
		"8Bits			CONF_WATCHASYNC_8BITS	\
		16Bits			CONF_WATCHASYNC_16BITS	\
		32Bits			CONF_WATCHASYNC_32BITS"	\
		16Bits			CONF_WATCHASYNC_COUNTERRANGE
  fi
  int "Buffersize (Power of 2)" CONF_WATCHASYNC_BUFFERSIZE 64
  bool "Use Polling for edge detect instead of interrupt " CONF_WATCHASYNC_EDGDETECTVIAPOLLING
  mainmenu_option next_comment
  comment "Pin Configuration"
    mainmenu_option next_comment
    comment "Port A"
      bool "Use Pin 0 of Port A" CONF_WATCHASYNC_PA0
      if [ "$CONF_WATCHASYNC_PA0" = "y" ]; then
        string "Pin 0 on Port A Identifier" CONF_WATCHASYNC_PA0_ID ""
          script_set "Generate random UUID" RANDOM_UUIDC "scripts/random_uuid CONF_WATCHASYNC_PA0_ID"
      fi
      bool "Use Pin 1 of Port A" CONF_WATCHASYNC_PA1
      if [ "$CONF_WATCHASYNC_PA1" = "y" ]; then
        string "Pin 1 on Port A Identifier" CONF_WATCHASYNC_PA1_ID ""
          script_set "Generate random UUID" RANDOM_UUIDC "scripts/random_uuid CONF_WATCHASYNC_PA1_ID"
      fi
      bool "Use Pin 2 of Port A" CONF_WATCHASYNC_PA2
      if [ "$CONF_WATCHASYNC_PA2" = "y" ]; then
        string "Pin 2 on Port A Identifier" CONF_WATCHASYNC_PA2_ID ""
          script_set "Generate random UUID" RANDOM_UUIDC "scripts/random_uuid CONF_WATCHASYNC_PA2_ID"
      fi
      bool "Use Pin 3 of Port A" CONF_WATCHASYNC_PA3
      if [ "$CONF_WATCHASYNC_PA3" = "y" ]; then
        string "Pin 3 on Port A Identifier" CONF_WATCHASYNC_PA3_ID ""
          script_set "Generate random UUID" RANDOM_UUIDC "scripts/random_uuid CONF_WATCHASYNC_PA3_ID"
      fi
      bool "Use Pin 4 of Port A" CONF_WATCHASYNC_PA4
      if [ "$CONF_WATCHASYNC_PA4" = "y" ]; then
        string "Pin 4 on Port A Identifier" CONF_WATCHASYNC_PA4_ID ""
          script_set "Generate random UUID" RANDOM_UUIDC "scripts/random_uuid CONF_WATCHASYNC_PA4_ID"
      fi
      bool "Use Pin 5 of Port A" CONF_WATCHASYNC_PA5
      if [ "$CONF_WATCHASYNC_PA5" = "y" ]; then
        string "Pin 5 on Port A Identifier" CONF_WATCHASYNC_PA5_ID ""
          script_set "Generate random UUID" RANDOM_UUIDC "scripts/random_uuid CONF_WATCHASYNC_PA5_ID"
      fi
      bool "Use Pin 6 of Port A" CONF_WATCHASYNC_PA6
      if [ "$CONF_WATCHASYNC_PA6" = "y" ]; then
        string "Pin 6 on Port A Identifier" CONF_WATCHASYNC_PA6_ID ""
          script_set "Generate random UUID" RANDOM_UUIDC "scripts/random_uuid CONF_WATCHASYNC_PA6_ID"
      fi
      bool "Use Pin 7 of Port A" CONF_WATCHASYNC_PA7
      if [ "$CONF_WATCHASYNC_PA7" = "y" ]; then
        string "Pin 7 on Port A Identifier" CONF_WATCHASYNC_PA7_ID ""
          script_set "Generate random UUID" RANDOM_UUIDC "scripts/random_uuid CONF_WATCHASYNC_PA7_ID"
      fi
    endmenu
    mainmenu_option next_comment
    comment "Port B"
      bool "Use Pin 0 of Port B" CONF_WATCHASYNC_PB0
      if [ "$CONF_WATCHASYNC_PB0" = "y" ]; then
        string "Pin 0 on Port B Identifier" CONF_WATCHASYNC_PB0_ID ""
          script_set "Generate random UUID" RANDOM_UUIDC "scripts/random_uuid CONF_WATCHASYNC_PB0_ID"
      fi
      bool "Use Pin 1 of Port B" CONF_WATCHASYNC_PB1
      if [ "$CONF_WATCHASYNC_PB1" = "y" ]; then
        string "Pin 1 on Port B Identifier" CONF_WATCHASYNC_PB1_ID ""
          script_set "Generate random UUID" RANDOM_UUIDC "scripts/random_uuid CONF_WATCHASYNC_PB1_ID"
      fi
      bool "Use Pin 2 of Port B" CONF_WATCHASYNC_PB2
      if [ "$CONF_WATCHASYNC_PB2" = "y" ]; then
        string "Pin 2 on Port B Identifier" CONF_WATCHASYNC_PB2_ID ""
          script_set "Generate random UUID" RANDOM_UUIDC "scripts/random_uuid CONF_WATCHASYNC_PB2_ID"
      fi
      bool "Use Pin 3 of Port B" CONF_WATCHASYNC_PB3
      if [ "$CONF_WATCHASYNC_PB3" = "y" ]; then
        string "Pin 3 on Port B Identifier" CONF_WATCHASYNC_PB3_ID ""
          script_set "Generate random UUID" RANDOM_UUIDC "scripts/random_uuid CONF_WATCHASYNC_PB3_ID"
      fi
      bool "Use Pin 4 of Port B" CONF_WATCHASYNC_PB4
      if [ "$CONF_WATCHASYNC_PB4" = "y" ]; then
        string "Pin 4 on Port B Identifier" CONF_WATCHASYNC_PB4_ID ""
          script_set "Generate random UUID" RANDOM_UUIDC "scripts/random_uuid CONF_WATCHASYNC_PB4_ID"
      fi
      bool "Use Pin 5 of Port B" CONF_WATCHASYNC_PB5
      if [ "$CONF_WATCHASYNC_PB5" = "y" ]; then
        string "Pin 5 on Port B Identifier" CONF_WATCHASYNC_PB5_ID ""
          script_set "Generate random UUID" RANDOM_UUIDC "scripts/random_uuid CONF_WATCHASYNC_PB5_ID"
      fi
      bool "Use Pin 6 of Port B" CONF_WATCHASYNC_PB6
      if [ "$CONF_WATCHASYNC_PB6" = "y" ]; then
        string "Pin 6 on Port B Identifier" CONF_WATCHASYNC_PB6_ID ""
          script_set "Generate random UUID" RANDOM_UUIDC "scripts/random_uuid CONF_WATCHASYNC_PB6_ID"
      fi
      bool "Use Pin 7 of Port B" CONF_WATCHASYNC_PB7
      if [ "$CONF_WATCHASYNC_PB7" = "y" ]; then
        string "Pin 7 on Port B Identifier" CONF_WATCHASYNC_PB7_ID ""
          script_set "Generate random UUID" RANDOM_UUIDC "scripts/random_uuid CONF_WATCHASYNC_PB7_ID"
      fi
    endmenu
    mainmenu_option next_comment
    comment "Port C"
      bool "Use Pin 0 of Port C" CONF_WATCHASYNC_PC0
      if [ "$CONF_WATCHASYNC_PC0" = "y" ]; then
        string "Pin 0 on Port C Identifier" CONF_WATCHASYNC_PC0_ID ""
          script_set "Generate random UUID" RANDOM_UUIDC "scripts/random_uuid CONF_WATCHASYNC_PC0_ID"
      fi
      bool "Use Pin 1 of Port C" CONF_WATCHASYNC_PC1
      if [ "$CONF_WATCHASYNC_PC1" = "y" ]; then
        string "Pin 1 on Port C Identifier" CONF_WATCHASYNC_PC1_ID ""
          script_set "Generate random UUID" RANDOM_UUIDC "scripts/random_uuid CONF_WATCHASYNC_PC1_ID"
      fi
      bool "Use Pin 2 of Port C" CONF_WATCHASYNC_PC2
      if [ "$CONF_WATCHASYNC_PC2" = "y" ]; then
        string "Pin 2 on Port C Identifier" CONF_WATCHASYNC_PC2_ID ""
          script_set "Generate random UUID" RANDOM_UUIDC "scripts/random_uuid CONF_WATCHASYNC_PC2_ID"
      fi
      bool "Use Pin 3 of Port C" CONF_WATCHASYNC_PC3
      if [ "$CONF_WATCHASYNC_PC3" = "y" ]; then
        string "Pin 3 on Port C Identifier" CONF_WATCHASYNC_PC3_ID ""
          script_set "Generate random UUID" RANDOM_UUIDC "scripts/random_uuid CONF_WATCHASYNC_PC3_ID"
      fi
      bool "Use Pin 4 of Port C" CONF_WATCHASYNC_PC4
      if [ "$CONF_WATCHASYNC_PC4" = "y" ]; then
        string "Pin 4 on Port C Identifier" CONF_WATCHASYNC_PC4_ID ""
          script_set "Generate random UUID" RANDOM_UUIDC "scripts/random_uuid CONF_WATCHASYNC_PC4_ID"
      fi
      bool "Use Pin 5 of Port C" CONF_WATCHASYNC_PC5
      if [ "$CONF_WATCHASYNC_PC5" = "y" ]; then
        string "Pin 5 on Port C Identifier" CONF_WATCHASYNC_PC5_ID ""
          script_set "Generate random UUID" RANDOM_UUIDC "scripts/random_uuid CONF_WATCHASYNC_PC5_ID"
      fi
      bool "Use Pin 6 of Port C" CONF_WATCHASYNC_PC6
      if [ "$CONF_WATCHASYNC_PC6" = "y" ]; then
        string "Pin 6 on Port C Identifier" CONF_WATCHASYNC_PC6_ID ""
          script_set "Generate random UUID" RANDOM_UUIDC "scripts/random_uuid CONF_WATCHASYNC_PC6_ID"
      fi
      bool "Use Pin 7 of Port C" CONF_WATCHASYNC_PC7
      if [ "$CONF_WATCHASYNC_PC7" = "y" ]; then
        string "Pin 7 on Port C Identifier" CONF_WATCHASYNC_PC7_ID ""
          script_set "Generate random UUID" RANDOM_UUIDC "scripts/random_uuid CONF_WATCHASYNC_PC7_ID"
      fi
    endmenu
    mainmenu_option next_comment
    comment "Port D"
      bool "Use Pin 0 of Port D" CONF_WATCHASYNC_PD0
      if [ "$CONF_WATCHASYNC_PD0" = "y" ]; then
        string "Pin 0 on Port D Identifier" CONF_WATCHASYNC_PD0_ID ""
          script_set "Generate random UUID" RANDOM_UUIDC "scripts/random_uuid CONF_WATCHASYNC_PD0_ID"
      fi
      bool "Use Pin 1 of Port D" CONF_WATCHASYNC_PD1
      if [ "$CONF_WATCHASYNC_PD1" = "y" ]; then
        string "Pin 1 on Port D Identifier" CONF_WATCHASYNC_PD1_ID ""
          script_set "Generate random UUID" RANDOM_UUIDC "scripts/random_uuid CONF_WATCHASYNC_PD1_ID"
      fi
      bool "Use Pin 2 of Port D" CONF_WATCHASYNC_PD2
      if [ "$CONF_WATCHASYNC_PD2" = "y" ]; then
        string "Pin 2 on Port D Identifier" CONF_WATCHASYNC_PD2_ID ""
          script_set "Generate random UUID" RANDOM_UUIDC "scripts/random_uuid CONF_WATCHASYNC_PD2_ID"
      fi
      bool "Use Pin 3 of Port D" CONF_WATCHASYNC_PD3
      if [ "$CONF_WATCHASYNC_PD3" = "y" ]; then
        string "Pin 3 on Port D Identifier" CONF_WATCHASYNC_PD3_ID ""
          script_set "Generate random UUID" RANDOM_UUIDC "scripts/random_uuid CONF_WATCHASYNC_PD3_ID"
      fi
      bool "Use Pin 4 of Port D" CONF_WATCHASYNC_PD4
      if [ "$CONF_WATCHASYNC_PD4" = "y" ]; then
        string "Pin 4 on Port D Identifier" CONF_WATCHASYNC_PD4_ID ""
          script_set "Generate random UUID" RANDOM_UUIDC "scripts/random_uuid CONF_WATCHASYNC_PD4_ID"
      fi
      bool "Use Pin 5 of Port D" CONF_WATCHASYNC_PD5
      if [ "$CONF_WATCHASYNC_PD5" = "y" ]; then
        string "Pin 5 on Port D Identifier" CONF_WATCHASYNC_PD5_ID ""
          script_set "Generate random UUID" RANDOM_UUIDC "scripts/random_uuid CONF_WATCHASYNC_PD5_ID"
      fi
      bool "Use Pin 6 of Port D" CONF_WATCHASYNC_PD6
      if [ "$CONF_WATCHASYNC_PD6" = "y" ]; then
        string "Pin 6 on Port D Identifier" CONF_WATCHASYNC_PD6_ID ""
          script_set "Generate random UUID" RANDOM_UUIDC "scripts/random_uuid CONF_WATCHASYNC_PD6_ID"
      fi
      bool "Use Pin 7 of Port D" CONF_WATCHASYNC_PD7
      if [ "$CONF_WATCHASYNC_PD7" = "y" ]; then
        string "Pin 7 on Port D Identifier" CONF_WATCHASYNC_PD7_ID ""
          script_set "Generate random UUID" RANDOM_UUIDC "scripts/random_uuid CONF_WATCHASYNC_PD7_ID"
      fi
    endmenu
  endmenu
  comment  "Debugging Flags"
    dep_bool 'WATCHASYNC' DEBUG_WATCHASYNC $DEBUG $WATCHASYNC_SUPPORT
endmenu
```

## stella/config.in
```kconfig
dep_bool_menu "Stella Light" STELLA_SUPPORT $UDP_SUPPORT
  int "Stella UDP Port" STELLA_UDP_PORT 2342
  dep_bool "Gamma correction (EXPERIMENTAL)" STELLA_GAMMACORRECTION $CONFIG_EXPERIMENTAL
  dep_bool "Higher frequency" STELLA_HIGHFREQ
  dep_bool "Moodlight" STELLA_MOODLIGHT
  dep_bool "Polling" STELLA_RESPONSE
  if [ "$STELLA_RESPONSE" = "y" ]; then
    int "Broadcast Response UDP Port" STELLA_BROADCAST_UDP_PORT 2341
    dep_bool "Acknowledge all packets" STELLA_RESPONSE_ACK
  fi
  comment  '----- Initial -----'
  choice 'Channels'			\
  "0% stella_start_zero	\
  100% stella_start_all	\
  EEPROM stella_start_eeprom	\
  Moodlight stella_start_moodlight"	\
  '0%' STELLA_START
  int "Fade step" STELLA_FADE_STEP_INIT 10
  int "Moodlight threshold" STELLA_MOODLIGHT_THRESHOLD_INIT 120
  choice 'Fade function'			\
  "Normal stella_fade_func_0	\
  Flashy stella_fade_func_1"	\
  'Normal' STELLA_FADE_FUNCTION_INIT
endmenu
```

## uip/config.in
```kconfig
###############################################################################
mainmenu_option next_comment
comment "Network protocols"

dep_bool 'TCP support' TCP_SUPPORT $UIP_SUPPORT
dep_bool 'UDP support' UDP_SUPPORT $UIP_SUPPORT
dep_bool 'UDP broadcast support' BROADCAST_SUPPORT $UDP_SUPPORT
dep_bool 'ICMP support' ICMP_SUPPORT $UIP_SUPPORT



comment "Application protocols"
dep_bool 'BOOTP support' BOOTP_SUPPORT $BROADCAST_SUPPORT $ENC28J60_SUPPORT $IPV4_SUPPORT
dep_bool 'Write BOOTP data to EEPROM' BOOTP_TO_EEPROM_SUPPORT $BOOTLOADER_SUPPORT $BOOTP_SUPPORT
source tftp/config.in

dep_bool 'DNS support' DNS_SUPPORT $UDP_SUPPORT
if [ "$DNS_SUPPORT" = "y" ]; then
  if [ "$IPV6_SUPPORT" = "y" ]; then
    ipv6 "DNS-Server IP address" CONF_DNS_SERVER "2001:6f8:1209:0:0:0:0:2"
  else
    ipv4 "DNS-Server IP address" CONF_DNS_SERVER "192.168.23.254"
  fi
fi

dep_bool 'SYSLOG support' SYSLOG_SUPPORT $CONFIG_EXPERIMENTAL $UDP_SUPPORT
if [ "$SYSLOG_SUPPORT" = "y" ]; then
  if [ "$IPV6_SUPPORT" = "y" ]; then
    ipv6 "SYSLOG-Server IP address" CONF_SYSLOG_SERVER "2001:4b88:10e4:0:21a:92ff:fe32:53e3"
  else
    ipv4 "SYSLOG-Server IP address" CONF_SYSLOG_SERVER "192.168.23.73"
  fi
fi

comment "Tunneling protocols"
dep_bool 'OpenVPN' OPENVPN_SUPPORT $UDP_SUPPORT
if [ "$OPENVPN_SUPPORT" = "y" ]; then
  mainmenu_option next_comment
  comment "OpenVPN configuration"
  hex "OpenVPN key" CONF_OPENVPN_KEY "00000000000000000000000000000000"
  hex "OpenVPN HMAC key" CONF_OPENVPN_HMAC_KEY "00000000000000000000000000000000"

  if [ "$IPV6_SUPPORT" != "y" -a "$BOOTP_SUPPORT" != "y" ]; then
    comment "OpenVPN IP configuration"
    ipv4 "OpenVPN IP address" CONF_OPENVPN_IP4 "192.168.23.244"
    ipv4 "OpenVPN netmask" CONF_OPENVPN_IP4_NETMASK "255.255.255.0"
    ipv4 "OpenVPN default gateway" CONF_OPENVPN_IP4_GATEWAY "192.168.23.1"
  fi
  endmenu
fi

dep_bool 'RFM12 raw' RFM12_RAW_SUPPORT $CONFIG_EXPERIMENTAL $RFM12_SUPPORT $ROUTER_SUPPORT
dep_bool 'ZBUS raw' ZBUS_RAW_SUPPORT $CONFIG_EXPERIMENTAL $ZBUS_SUPPORT $ROUTER_SUPPORT
endmenu
```

## zbus/config.in
```kconfig
mainmenu_option next_comment
comment "ZBUS configuration"

  if [ "$ZBUS_SUPPORT" = "y" ]; then
    choice '  ZBus usart select' "$(usart_choice ZBUS)"
    usart_process_choice ZBUS

    int "ZBus Baudrate" CONF_ZBUS_BAUDRATE "19200"

    if [ "$SKIPJACK_SUPPORT" = "y" ]; then
      hex "Skipjack Key" CONF_ZBUS_KEY "23234242555523234242"
    fi

    if [ "$ROUTER_SUPPORT" = "y" ]; then
      if [ "$IPV6_SUPPORT" = "y" ]; then
	ipv6 "IP address" CONF_ZBUS_IP "2001:6f8:1209:23:aede:48ff:fe0b:ee52"
	int "IP prefix length" CONF_ZBUS_IP6_PREFIX_LEN 64
      else
	ipv4 "IP address" CONF_ZBUS_IP "192.168.5.1"
	ipv4 "Netmask" CONF_ZBUS_IP4_NETMASK "255.255.255.0"
      fi
    fi
  fi

  dep_bool "ZBUS ARP-Proxy" ZBUS_ARP_PROXY $ENC28J60_SUPPORT $ZBUS_SUPPORT

endmenu
```
