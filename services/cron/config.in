## services/pam/config.in
```kconfig
dep_bool_menu "PAM Support" PAM_SUPPORT
	if [ "$PAM_SUPPORT" = "y" ]; then
	  choice '  PAM Subsystem' \
		"None pam_none \
		 Single_User pam_single_user \
		 Single_User_EEPROM pam_single_user_eeprom \
		 LDAP pam_ldap" \
		 None PAM_SUBSYSTEM

		if [ "$PAM_SUBSYSTEM" = "pam_single_user" ]; then
			string "  PAM Username" "PAM_SINGLE_USERNAME" "root"
			string "  PAM Password" "PAM_SINGLE_PASSWORD" "fixme"
		fi

		if [ "$PAM_SUBSYSTEM" = "pam_single_user_eeprom" ]; then
			string "  PAM Username (default)" "PAM_SINGLE_USERNAME" "root"
			string "  PAM Password (default)" "PAM_SINGLE_PASSWORD" "fixme"
		fi

		if [ "$PAM_SUBSYSTEM" = "pam_ldap" ]; then
			ip "  LDAP Server IP" CONF_LDAP_AUTH_IP "192.168.98.128"
			string "  LDAP User DN Template" CONF_LDAP_AUTH_DN "userid=%s,ou=Stettberger,ou=People,dc=zerties,dc=org"
			dep_bool '  Debug LDAP Auth' DEBUG_LDAP_AUTH $DEBUG
		fi

		define_bool `echo $PAM_SUBSYSTEM | tr 'a-z' 'A-Z'`_SUPPORT y  # e.g. PAM_LDAP_SUPPORT
	fi
endmenu
```

## services/projectors/sanyoZ700/config.in
```kconfig
usart_count_used
if [ "$PROJECTOR_SANYO_Z700_SUPPORT" = y -o $USARTS -gt $USARTS_USED ]; then
	dep_bool_menu "Projectors: SanyoZ700" PROJECTOR_SANYO_Z700_SUPPORT
		choice '    SanyoZ700 usart select' "$(usart_choice SANYO_Z700)"
		usart_process_choice SANYO_Z700
	comment  "Debugging Flags"
	dep_bool 'SANYO_Z700 Debug' DEBUG_SANYO_Z700 $PROJECTOR_SANYO_Z700_SUPPORT
	endmenu
else
	define_bool PROJECTOR_SANYO_Z700_SUPPORT n
	comment "SANYO_Z700 not available. No free usart. ($USARTS_USED/$USARTS)"
fi
```

## services/stella/config.in
```kconfig
dep_bool_menu "StellaLight: Multichannel pwm" STELLA_SUPPORT $ARCH_AVR
	choice 'Stella Frequency'			\
	    "Very_Slow stella_vslow	\
	    Slow stella_slow	\
	    Normal stella_normal	\
	    Fast stella_fast"	\
	    'Normal' STELLA_FREQ
	bool "Low Interrupt Priority" STELLA_LOW_PRIORITY
	comment  '----- Startup settings -----'
	if [ "$MOODLIGHT_SUPPORT" = "y" ]; then
		choice 'Channels'			\
		"0% stella_start_zero	\
		100% stella_start_all	\
		EEPROM stella_start_eeprom	\
		Moodlight stella_start_moodlight"	\
		'0%' STELLA_START
	else
		choice 'Channels'			\
		"0% stella_start_zero	\
		100% stella_start_all	\
		EEPROM stella_start_eeprom"	\
		'0%' STELLA_START
	fi
	int "Fade step" STELLA_FADE_STEP_INIT 10
	choice 'Fade function'			\
	"Normal stella_fade_func_0	\
	Flashy stella_fade_func_1"	\
	'Normal' STELLA_FADE_FUNCTION_INIT
	if [ "$DMX_STORAGE_SUPPORT" = "y" ]; then
		comment  '----- DMX -----'
		int "Stella DMX Universe" STELLA_UNIVERSE 1
		int "Offset in Universe" STELLA_UNIVERSE_OFFSET 0
	else
		comment  '----- DMX not available (please enable DMX Storage) -----'
	fi
	dep_bool "Use CIE1931 Brightness correction" STELLA_USE_CIE1931	$STELLA_SUPPORT
	dep_bool 'Debug' DEBUG_STELLA $DEBUG
endmenu
```
