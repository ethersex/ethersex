## hardware/serial_ram/config.in
```kconfig
dep_bool_menu "Serial RAM support" SER_RAM_SUPPORT
	source hardware/serial_ram/23k256/config.in 
endmenu
```

## hardware/sms/config.in
```kconfig
dep_bool_menu "SMS Support" SMS_SUPPORT $ARCH_AVR
		choice '  SMS' "$(usart_choice SMS)"
		usart_process_choice SMS
		comment  "Debugging Flags"
		dep_bool 'SMS' DEBUG_SMS $DEBUG
endmenu
```

## hardware/storage/config.in
```kconfig
mainmenu_option next_comment

  comment "Storage"

  source hardware/storage/dataflash/config.in
  source hardware/storage/sd_reader/config.in
  source hardware/serial_ram/config.in

endmenu
```

## i2c/config.in
```kconfig
  if [ "$CONFIG_EXPERIMENTAL" = "y" -a "$UDP_SUPPORT" = "y" ]; then
    choice 'I2C support' \
	    "None			CONFIG_NO_I2C		\
	     I2C-Master			I2C_SUPPORT		\
	     I2C-Slave			I2C_SLAVE_SUPPORT"	\
	     'None'
  fi

  if [ "$I2C_SLAVE_SUPPORT" = "y" ]; then
    int "I2C slave address" CONF_I2C_SLAVE_ADDR 42
  fi
```

## kty/config.in
```kconfig
  dep_bool  "KTY Calculation Support" KTY_SUPPORT $ADC_SUPPORT
  if [ "$KTY_SUPPORT" = "y" ]; then
    choice '  KTY81 Device' "110 KTY_DEVICE" '110'
  fi
```

## lcd/config.in
```kconfig
dep_bool_menu "HD44780 module driver (Character-LCD)" HD44780_SUPPORT
  if [ "$HD44780_SUPPORT" = "y" ]; then
    choice 'Controller type'					\
	    "Original			HD44780_ORIGINAL	\
	     ks0067b			HD44780_KS0067B"	\
	    Original
    define_bool LCD_SUPPORT y
  fi
  dep_bool "Readback support" HD44780_READBACK $HD44780_SUPPORT
  dep_bool "Use Port C (instead of Port A)" HD44780_USE_PORTC $HD44780_SUPPORT
endmenu
```

## mcuf/config.in
```kconfig
dep_bool_menu "Blinkenlights - MicroControllerUnitFrame" MCUF_SUPPORT $UDP_SUPPORT $ARCH_AVR

  usart_count_used
	if [ "$MCUF_SERIAL_SUPPORT" = y -o $USARTS -gt $USARTS_USED ]; then
		dep_bool "MCUF usart" MCUF_SERIAL_SUPPORT $MCUF_SUPPORT
		choice '    MCUF usart select' "$(usart_choice MCUF)"
		usart_process_choice MCUF
		if [ "$MCUF_SERIAL_SUPPORT" = y ]; then
			comment "MCUF serial screen configuration"
			int "MCUF serial screen width" MCUF_SERIAL_SCREEN_WIDTH 18
			int "MCUF serial screen height" MCUF_SERIAL_SCREEN_HEIGHT 8
		fi
	else
		comment "MCUF usart not available. No free usart. ($USARTS_USED/$USARTS)"
		define_bool MCUF_SERIAL_SUPPORT n
	fi

  dep_bool_menu "MCUF output" MCUF_OUTPUT_SUPPORT $MCUF_SUPPORT
    if [ "$MCUF_OUTPUT_SUPPORT" = y ]; then
      choice 'Output Device'\
	"BlinkenLightsPro	BLP_SUPPORT\
	 LED-Module16x16rg	LEDRG_SUPPORT"\
	 BlinkenLightsPro
      if [ "$BLP_SUPPORT" = y ]; then
        comment "MCUF output screen is 18x8 pixels"
        define_int MCUF_OUTPUT_SCREEN_WIDTH 18
        define_int MCUF_OUTPUT_SCREEN_HEIGHT 8
		define_bool BLP_SUPPORT y
      elif [ "$LEDRG_SUPPORT" = y ]; then
        comment "MCUF output screen is 16x16 pixels"
        define_int MCUF_OUTPUT_SCREEN_WIDTH 16
        define_int MCUF_OUTPUT_SCREEN_HEIGHT 16
		define_bool LEDRG_SUPPORT y
      fi
    else
      define_bool BLP_SUPPORT n
      define_bool LEDRG_SUPPORT n
    fi
  endmenu

  dep_bool "Workaround for MCUF-UDP-Packets with wrong max-value" MCUF_SERIAL_WORKAROUND_FOR_BAD_MCUF_UDP_PACKETS $MCUF_SUPPORT

  comment "MCUF ecmd commandos"
  dep_bool_menu "MCUF Scrolltext" MCUF_SCROLLTEXT_SUPPORT $MCUF_SUPPORT
    string "Startup Message" CONF_MCUF_SCROLLTEXT_STARTUP "Hi  I am your ethersex        ;-)  "
    int "Startup Message Color" CONF_MCUF_SCROLLTEXT_STARTUP_COLOR 240
    int "Startup Message Background Color" CONF_MCUF_SCROLLTEXT_STARTUP_BG_COLOR 1
    int "Startup Message Speed" CONF_MCUF_SCROLLTEXT_STARTUP_SPEED 2 
  endmenu
  dep_bool "MCUF Clock" MCUF_CLOCK_SUPPORT $MCUF_SUPPORT $CLOCK_SUPPORT
  dep_bool "  Clock autostart" MCUF_CLOCK_AUTOSTART_SUPPORT $MCUF_SUPPORT $CLOCK_SUPPORT $MCUF_CLOCK_SUPPORT

  comment "MCUF Module"
  dep_bool_menu "MCUF Module" MCUF_MODUL_SUPPORT $MCUF_SUPPORT $MCUF_OUTPUT_SUPPORT $CONFIG_EXPERIMENTAL
    dep_bool_menu "MCUF Module in Cron" MCUF_MODUL_CRON_SUPPORT $MCUF_SUPPORT $CRON_STATIC_SUPPORT
    choice 'Modul Display Mode Cron' \
     "sequence        MCUF_MODUL_DISPLAY_MODE_CRON_SEQUENCE \
      random          MCUF_MODUL_DISPLAY_MODE_CRON_RANDOM" \
      'random' MCUF_MODUL_DISPLAY_MODE_CRON
    endmenu
    dep_bool_menu "MCUF Module Display Mode" MCUF_MODUL_DISPLAY_MODE_SUPPORT $MCUF_SUPPORT $ECMD_PARSER_SUPPORT
    choice 'ECMD Modul Display Mode' \
     "sequence        MCUF_MODUL_DISPLAY_MODE_SEQUENCE \
      random          MCUF_MODUL_DISPLAY_MODE_RANDOM \
      manual          MCUF_MODUL_DISPLAY_MODE_MANUAL" \
      'random' MCUF_MODUL_DISPLAY_MODE
    endmenu
    dep_bool "MCUF Game Input Test" MCUF_TEST_GAME_INPUT $MCUF_MODUL_SUPPORT $BUTTONS_INPUT_SUPPORT
    dep_bool "MCUF Chess" MCUF_CHESS_SUPPORT $MCUF_MODUL_SUPPORT
    dep_bool "MCUF Box" MCUF_BOX_SUPPORT $MCUF_MODUL_SUPPORT
    dep_bool "MCUF Clean" MCUF_CLEAN_SUPPORT $MCUF_MODUL_SUPPORT
    dep_bool "MCUF Spiral" MCUF_SPIRAL_SUPPORT $MCUF_MODUL_SUPPORT
    dep_bool "MCUF Image" MCUF_IMAGE_SUPPORT $MCUF_MODUL_SUPPORT
    dep_bool_menu "MCUF Module Borg-16" MCUF_MODUL_BORG16_SUPPORT $MCUF_SUPPORT
      dep_bool "MCUF Xoni Study1" MCUF_MODUL_BORG16_XONI_STUDY_SUPPORT $MCUF_MODUL_BORG16_SUPPORT
      dep_bool "MCUF Snake" MCUF_MODUL_BORG16_SNAKE_SUPPORT $MCUF_MODUL_BORG16_SUPPORT
      dep_bool "MCUF Snake Interactive" MCUF_MODUL_BORG16_SNAKE_INTERACTIVE_SUPPORT $MCUF_MODUL_BORG16_SUPPORT $GAME_INPUT_SUPPORT
    endmenu
  endmenu

	comment  "Debugging Flags"
	dep_bool 'MCUF' DEBUG_MCUF $DEBUG
	
endmenu
```

## net/config.in
```kconfig
source ../httpd/config.in

dep_bool "MDNS service announcement (Avahi)" MDNS_SD_SUPPORT $UDP_SUPPORT
dep_bool "Stella Light" STELLA_SUPPORT $UDP_SUPPORT
dep_bool "UDP Echo" UDP_ECHO_NET_SUPPORT $UDP_SUPPORT

mainmenu_option next_comment
comment "DynDNS support"
  dep_bool "Update DNS records at dyn.metafnord.de" DYNDNS_SUPPORT $UIP_SUPPORT
  if [ "$DYNDNS_SUPPORT" = "y" ]; then
    string "Hostname" CONF_DYNDNS_HOSTNAME "camera1"
    string "Username" CONF_DYNDNS_USERNAME "user"
    string "Password" CONF_DYNDNS_PASSWORD "secret"
  fi
endmenu

dep_bool_editor "Watch IO changes (and react)" WATCHCAT_SUPPORT "watchcat/config" $ECMD_SENDER_SUPPORT $PORTIO_SUPPORT
dep_bool "Simple Network Managment Protocol support (snmp)" SNMP_SUPPORT $UDP_SUPPORT $CONFIG_EXPERIMENTAL
if [ "$SNMP_SUPPORT" = "y" ]; then
  string "  SNMP Description" SNMP_VALUE_DESCRIPTION "ethersex"
  string "  SNMP Location"    SNMP_VALUE_LOCATION    "over the rainbow"
  string "  SNMP Contact"     SNMP_VALUE_CONTACT     "http://www.ethersex.de"
fi


dep_bool_menu "Sendmail support (smtp)" SENDMAIL_SUPPORT $TCP_SUPPORT $CONFIG_EXPERIMENTAL
if [ "$SENDMAIL_SUPPORT" = "y" ]; then
  ip "SMTP IP address" CONF_SENDMAIL_IP "78.47.210.246"
  string "SMTP From Address" CONF_SENDMAIL_FROM "root@sex.metafnord.de"
  string "SMTP To Address" CONF_SENDMAIL_TO "stesie@brokenpipe.de"
  dep_bool "SMTP Auth Support" SENDMAIL_AUTH_SUPPORT $SENDMAIL_SUPPORT
  if [ "$SENDMAIL_AUTH_SUPPORT" = "y" ]; then
    string "SMTP Auth Username" CONF_SENDMAIL_USERNAME "tester"
    string "SMTP Auth Password" CONF_SENDMAIL_PASSWORD "tester"
  fi
fi
endmenu 
```

## protocols/bsbport/config.in
```kconfig
usart_count_used
if [ "$BSBPORT_SUPPORT" = y -o $USARTS -gt $USARTS_USED ]; then
	dep_bool_menu "BSBPort Support" BSBPORT_SUPPORT $TCP_SUPPORT $ARCH_AVR
		choice '    BSBPort usart select' "$(usart_choice BSBPORT)"
		usart_process_choice BSBPORT
		int    "BSBPort TCP Port" BSBPORT_PORT 3000
		int    "BSBPort Baudrate" BSBPORT_BAUDRATE 4800

		if [ "$BSBPORT_BUFFER_LEN" = "" ] ; then
			BSBPORT_BUFFER_LEN=32
		fi
		if [ "$BSBPORT_BUFFER_LEN" -gt "$NET_MAX_FRAME_LENGTH" ] ; then
			BSBPORT_BUFFER_LEN=$NET_MAX_FRAME_LENGTH
		fi
		int    "BSBPort Buffer Length" BSBPORT_BUFFER_LEN 32
		int    "BSBPort Max Buffer Flush Interval (N*20ms)" BSBPORT_FLUSH 25
		int    "BSBPort Message History Size" BSBPORT_MESSAGE_BUFFER_LEN 10
		int    "BSBPort Message Max Length" BSBPORT_MESSAGE_MAX_LEN 25
		int    'BSBPORT Address' BSBPORT_OWNADDRESS 7
		dep_bool 'BSBPORT Polling Support' BSBPORT_POLLING_SUPPORT $BSBPORT_SUPPORT
	comment  "Debugging Flags"
	dep_bool 'BSBPORT Debug Rx' DEBUG_BSBPORT_RX $BSBPORT_SUPPORT
	dep_bool 'BSBPORT Debug Tx' DEBUG_BSBPORT_TX $BSBPORT_SUPPORT
	dep_bool 'BSBPORT Debug Message Parsing' DEBUG_BSBPORT_PARSE $BSBPORT_SUPPORT
	dep_bool 'BSBPORT Debug ECMD Output' DEBUG_BSBPORT_ECMD $BSBPORT_SUPPORT
	endmenu
else
	define_bool BSBPORT_SUPPORT n
	comment "BSBPORT not available. No free usart. ($USARTS_USED/$USARTS)"
fi
```

## protocols/config.in
```kconfig
mainmenu_option next_comment
comment "Protocols"

source protocols/artnet/config.in
source protocols/dali/config.in
source protocols/dmx/config.in
source protocols/ecmd/config.in
source protocols/eltakoms/config.in
source protocols/ems/config.in
source protocols/fnordlicht/config.in
source protocols/httplog/config.in
source protocols/irc/config.in
source protocols/mdns_sd/config.in
source protocols/modbus/config.in
source protocols/mqtt/config.in
source protocols/mysql/config.in
source protocols/netstat/config.in
source protocols/radio/config.in
source protocols/sip/config.in
source protocols/soap/config.in
source protocols/snmp/config.in
source protocols/smtp/config.in
source protocols/sms77/config.in
source protocols/syslog/config.in
source protocols/twitter/config.in
source protocols/ustream/config.in
source protocols/yport/config.in
source protocols/bsbport/config.in
source protocols/msr1/config.in
source protocols/to1/config.in
source protocols/serial_line_log/config.in
source protocols/nmea/config.in
source protocols/udpstella/config.in
source protocols/udpIO/config.in
source protocols/udpcurtain/config.in
source protocols/cw/config.in
source protocols/sgc/config.in
endmenu
```
