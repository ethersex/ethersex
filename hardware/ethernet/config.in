## hardware/lcd/s1d13305/config.in
```kconfig
dep_bool_menu "S1D13305 module driver (GLCD)" S1D13305_SUPPORT $ARCH_AVR
    if [ "$S1D13305_SUPPORT" = "y" ]; then
	choice 'Display mode'					    \
           "Text/Graphics   S1D13305_MIXED		\
	       Graphics			S1D13305_GRAPHICS"	\
           Text/Graphics	S1D13305_MODE
	comment 'Display size'
		int "X" CONF_S1D13305_RESX 320
		int "Y" CONF_S1D13305_RESY 240
	comment 'Controller settings'
		int "XTAL" CONF_S1D13305_XTAL 10000000
		int "Refresh rate" CONF_S1D13305_REFRESH 75
		bool "Backlight support" LCD_BACKLIGHT_SUPPORT y
      define_bool LCD_SUPPORT y
    fi
	comment  "Debugging Flags"
	dep_bool 'S1D13305' DEBUG_S1D13305 $DEBUG $S1D13305_SUPPORT
  endmenu
```

## hardware/radio/bluetooth/config.in
```kconfig
usart_count_used
if [ "$BLUETOOTH_SUPPORT" = y -o $USARTS -gt $USARTS_USED ]; then

  dep_bool_menu "Bluetooth" BLUETOOTH_SUPPORT $ARCH_AVR
  if [ "$BLUETOOTH_SUPPORT" = y ]; then
    choice '  Bluetooth usart select' "$(usart_choice BLUETOOTH)"
    usart_process_choice BLUETOOTH
    int "USART Baudrate" BLUETOOTH_BAUDRATE 115200
    string "Device Name" BLUETOOTH_NAME "ethersex"
    string "Device PIN" BLUETOOTH_PIN "1234"

    comment  "ECMD"
    if [ "$TEENSY_SUPPORT" = "y" ]; then
      dep_bool 'AT Command Interface' BLUETOOTH_ECMD $BLUETOOTH_SUPPORT n
    else
      dep_bool 'AT Command Interface' BLUETOOTH_ECMD $BLUETOOTH_SUPPORT
    fi

    comment  "Debugging Flags"
    dep_bool 'Bluetooth' DEBUG_BLUETOOTH $BLUETOOTH_SUPPORT $DEBUG
  fi
  endmenu
else
  define_bool BLUETOOTH_SUPPORT n
  comment "BLUETOOTH not available. No free usart. ($USARTS_USED/$USARTS)"
fi
```

## hardware/radio/config.in
```kconfig
mainmenu_option next_comment

  comment "Radio"

  source hardware/radio/fs20/config.in
  source hardware/radio/rfm12/rfm12_ask_config.in
  source hardware/radio/generic/config.in

endmenu
```

## hardware/radio/rfm12/config.in
```kconfig
rfm12_count_used

if [ "$RFM12_IP_SUPPORT" = "y" -o $RFM12S -gt $RFM12S_USED ]; then

  dep_bool_menu "IP over RFM12 (FSK transmitter) support" RFM12_IP_SUPPORT $ARCH_AVR

    choice "RFM12 select" "$(rfm12_choice RFM12_IP)"
    rfm12_process_choice RFM12_IP

    choice 'RFM12 frequency'  \
      "433.920MHz  RFM12_FREQ_433920  \
       869.775MHz  RFM12_FREQ_869775  \
       869.800MHz  RFM12_FREQ_869800  \
       869.825MHz  RFM12_FREQ_869825  \
       869.850MHz  RFM12_FREQ_869850  \
       869.875MHz  RFM12_FREQ_869875  \
       869.900MHz  RFM12_FREQ_869900  \
       869.925MHz  RFM12_FREQ_869925" \
      '433.920MHz'  CONF_RFM12_FREQ

    dep_bool "Use slow SPI" CONF_RFM12_SLOW_SPI
    dep_bool "Use RFM12B" CONF_RFM12B_SUPPORT

    if [ "$TEENSY_SUPPORT" != "y" ]; then
      int "RFM12 Baudrate" CONF_RFM12_BAUD 19200
    fi

    if [ "$IPV6_SUPPORT" = "y" ]; then
      ipv6 "IP address" CONF_RFM12_IP "2001:6f8:1209:23:aede:48ff:fe0b:ee52"
      int "IP prefix length" CONF_RFM12_IP6_PREFIX_LEN 64
    else
      ipv4 "IP address" CONF_RFM12_IP "192.168.5.1"
      ipv4 "Netmask" CONF_RFM12_IP4_NETMASK "255.255.255.0"
    fi

    dep_bool "Source Route ALL packets" RFM12_SOURCE_ROUTE_ALL $RFM12_IP_SUPPORT
    if [ "$RFM12_SOURCE_ROUTE_ALL" = "y" ]; then
      int "  Router ID" CONF_RFM12_SOURCE_ROUTE_ALL_RTRID 17
    fi

    dep_bool "RFM12 Packet Forwarding" RFM12_PCKT_FWD $RFM12_IP_SUPPORT
    if [ "$RFM12_PCKT_FWD" = "y" ]; then
      int "  Station ID" CONF_RFM12_STATID 17
    fi

    dep_bool "RFM12 ARP-Proxy" RFM12_ARP_PROXY $ENC28J60_SUPPORT $RFM12_IP_SUPPORT

    if [ "$RFM12_IP_SUPPORT" != "y" ]; then
      bool "Disable RFM12 module" RFM12_DISABLE
    fi

  endmenu

else
  comment "RFM12 IP Support not available. No Free RFM12. ($RFM12S_USED/$RFM12S)"
fi
```
