## hardware/ethernet/config.in
```kconfig
dep_bool_menu "Ethernet (ENC28J60) support" ENC28J60_SUPPORT $ARCH_AVR
	mac "MAC address" CONF_ENC_MAC "ac:de:48:fd:0f:d0"
	script_set "  Randomize MAC address" RANDOM_MAC "scripts/random_mac CONF_ENC_MAC"

	dep_bool 'Static IPv6 configuration' IPV6_STATIC_SUPPORT $IPV6_SUPPORT

	if [ "$IPV6_STATIC_SUPPORT" = "y" ]; then
		comment "Static IPv6 configuration"
		ipv6 "IP address" CONF_ENC_IP "2001:6f8:1209:23:0:0:fe9b:ee52"
		int "IP prefix length" CONF_ENC_IP6_PREFIX_LEN 64
	fi

	if [ "$IPV6_SUPPORT" != "y" -a "$BOOTP_SUPPORT" != "y" -a "$DHCP_SUPPORT" != "y" ]; then
		comment "Static IPv4 configuration"
		ipv4 "IP address" CONF_ENC_IP "192.168.23.244"
		ipv4 "Netmask" CONF_ENC_IP4_NETMASK "255.255.255.0"
	fi

	dep_bool "802.1q Support" IEEE8021Q_SUPPORT
	if [ "$IEEE8021Q_SUPPORT" = "y" ]; then
		int "VLAN ID (1 to 4094)" CONF_8021Q_VID 1
		int "User Priority (0 to 7)" CONF_8021Q_PRIO 1
	fi

	choice 'ENC28J60 CLKOUT Prescaler (ECOCON)' \
		"Unset  ECOCON_UNSET \
		 3.125MHz(8)  ECOCON_6 \
		 6.250MHz(4)  ECOCON_4 \
		 8.333MHz(3)  ECOCON_3 \
		 12.50MHz(2)  ECOCON_2 \
		 25.00MHz(1)  ECOCON_1 \
		 CLKOUT_Off  ECOCON_0" \
		'Unset' CONF_ENC_ECOCON

	comment  "Debugging Flags"
	dep_bool 'ENC28J60' DEBUG_ENC28J60 $DEBUG $ENC28J60_SUPPORT
	dep_bool '  Interrupt' DEBUG_INTERRUPT $DEBUG_ENC28J60
	dep_bool '  Rev. 4 Workaround' DEBUG_REV4_WORKAROUND $DEBUG_ENC28J60
	
endmenu

if [ "$ENC28J60_SUPPORT" = "y" -o "$TAP_SUPPORT" = "y" ]; then
	define_bool ETHERNET_SUPPORT y
else
	define_bool ETHERNET_SUPPORT n

	if [ "$IPV6_SUPPORT" = "y" ]; then
		define_bool "IPV6_STATIC_SUPPORT" y
	else
		define_bool "IPV6_STATIC_SUPPORT" n
	fi
fi
```

## hardware/i2c/config.in
```kconfig
mainmenu_option next_comment

  comment "I2C"

  source hardware/i2c/master/config.in
  source hardware/i2c/slave/config.in

endmenu
```

## hardware/i2c/master/config.in
```kconfig
dep_bool_menu "I2C Master Support" I2C_MASTER_SUPPORT $ARCH_AVR
  if [ "$I2C_MASTER_SUPPORT" = "y" ]; then
    int "I2C master baudrate in kHz" CONF_I2C_BAUD 400
  fi
  dep_bool "  I2C detection support"	I2C_DETECT_SUPPORT $I2C_MASTER_SUPPORT
  dep_bool_menu "  I2C generic read/write support"	I2C_GENERIC_SUPPORT $I2C_MASTER_SUPPORT
  if [ "$I2C_GENERIC_SUPPORT" = "y" ]; then
  	dep_bool "Add delays for slow devices"	I2C_GENERIC_DELAYS $I2C_GENERIC_SUPPORT
  fi
  endmenu
  dep_bool "  I2C EEPROM (24cxx) support"	I2C_24CXX_SUPPORT $I2C_MASTER_SUPPORT
  if [ "$I2C_24CXX_SUPPORT" = "y" ]; then
    int "I2C 24CXX Pagesize" CONF_I2C_24CXX_PAGESIZE 128
  fi
  dep_bool "  I2C LM75   temperature sensor" I2C_LM75_SUPPORT $I2C_MASTER_SUPPORT
  dep_bool "  I2C TMP175 temperature sensor" I2C_TMP175_SUPPORT $I2C_MASTER_SUPPORT
  dep_bool "  I2C DS1631 temperature sensor" I2C_DS1631_SUPPORT $I2C_MASTER_SUPPORT
  dep_bool "  I2C DS13X7  RTC" I2C_DS13X7_SUPPORT $I2C_MASTER_SUPPORT
  if [ "$I2C_DS13X7_SUPPORT" = "y" ]; then
  	choice 'RTC Type'			\
		"DS1307		DS1307		\
		 DS1337		DS1337"		\
		'DS1307' I2C_DS13X7_TYPE
  fi
  dep_bool "  I2C PCF8583 RTC" I2C_PCF8583_SUPPORT $I2C_MASTER_SUPPORT
  if [ "$I2C_PCF8583_SUPPORT" = "y" ]; then
    dep_bool "    Pin A0 on Vcc" I2C_PCF8583_A0_VCC $I2C_PCF8583_SUPPORT
    dep_bool "    Sync system clock" I2C_PCF8583_SYNC $I2C_PCF8583_SUPPORT
    if [ "$I2C_PCF8583_SYNC" = "y" ]; then
      int "    Sync period in sec" I2C_PCF8583_SYNC_PERIOD 60 $I2C_PCF8583_SYNC
    fi
  fi
  dep_bool "  I2C TSL2550 light sensor" I2C_TSL2550_SUPPORT $I2C_MASTER_SUPPORT
  dep_bool "  I2C TSL2561 light sensor" I2C_TSL2561_SUPPORT $I2C_MASTER_SUPPORT

  dep_bool "  I2C BMP085 barometric pressure sensor" I2C_BMP085_SUPPORT $I2C_MASTER_SUPPORT
  if [ "$I2C_BMP085_SUPPORT" = "y" ]; then
    dep_bool "    BMP085 advanced barometric calculations" I2C_BMP085_BAROCALC_SUPPORT $I2C_MASTER_SUPPORT
    choice '    BMP085 Pressure Oversampling' \
        "0    BMP085_OSS_0  \
         1    BMP085_OSS_1  \
         2    BMP085_OSS_2  \
         3    BMP085_OSS_3"  \
        'BMP085_OSS_3' I2C_BMP085_OVERSAMPLING
  fi

  dep_bool "  I2C PCA9531  8-bit LED dimmer" I2C_PCA9531_SUPPORT $I2C_MASTER_SUPPORT
  dep_bool "  I2C PCA9685 12-bit LED dimmer" I2C_PCA9685_SUPPORT $I2C_MASTER_SUPPORT
  dep_bool "  I2C PCF8574X 8-bit port extension" I2C_PCF8574X_SUPPORT $I2C_MASTER_SUPPORT
  dep_bool "  I2C PCA9555 16-bit port extension" I2C_PCA9555_SUPPORT $I2C_MASTER_SUPPORT
  dep_bool "  I2C MAX7311 16-bit port extension" I2C_MAX7311_SUPPORT $I2C_MASTER_SUPPORT
  dep_bool "  I2C to UDP gateway" I2C_UDP_SUPPORT $I2C_MASTER_SUPPORT $UDP_SUPPORT
  if [ "$I2C_UDP_SUPPORT" = "y" ]; then
    int "I2C to UDP gateway port" I2C_PORT 8995 $I2C_UDP_SUPPORT
  fi

	comment  "Debugging Flags"
	dep_bool 'I2C' DEBUG_I2C $DEBUG

endmenu
```

## hardware/input/buttons/config.in
```kconfig
dep_bool_menu "Buttons Input" BUTTONS_INPUT_SUPPORT $ARCH_AVR
if [ "$BUTTONS_INPUT_SUPPORT" = "y" ]; then
	comment "I/O Pin configuration"
	dep_bool "Use internal pullups" CONF_BUTTONS_USE_PULLUPS $BUTTONS_INPUT_SUPPORT
	choice "Button active level"     \
    	"HIGH CONF_BUTTONS_LEVEL_HIGH \
	 	 LOW CONF_BUTTONS_LEVEL_LOW"  \
        'LOW'
	if [ "$CONF_BUTTONS_LEVEL_HIGH" = "y" ]; then
      define_int CONF_BUTTONS_LEVEL 1
    else
      define_int CONF_BUTTONS_LEVEL 2
    fi

	comment  "Timing parameters"
	int "Debounce delay (x * 20 ms)" CONF_BUTTONS_DEBOUNCE_DELAY 4
	int "Longpress delay (x * 20 ms)" CONF_BUTTONS_LONGPRESS_DELAY 100
	
	comment  "Repeat function"
	dep_bool "Enable repeat" CONF_BUTTONS_USE_REPEAT $BUTTONS_INPUT_SUPPORT
	if [ "$CONF_BUTTONS_USE_REPEAT" = "y" ]; then
		int "Repeat delay (x * 20 ms)" CONF_BUTTONS_REPEAT_DELAY 175
		int "Repeat rate (x * 20 ms)" CONF_BUTTONS_REPEAT_RATE 25
	fi
	comment  "Debugging Flags"
	dep_bool "Button input Debug" DEBUG_BUTTONS $DEBUG $BUTTONS_INPUT_SUPPORT
fi	
endmenu
```

## hardware/ir/config.in
```kconfig
mainmenu_option next_comment

  comment "IR Receivers"

  source hardware/ir/rc5/config.in
  source hardware/ir/irmp/config.in

endmenu
```

## hardware/ir/rc5/config.in
```kconfig
dep_bool_menu "RC5 IR (deprecated)" RC5_SUPPORT $ARCH_AVR

	dep_bool "Send RC5 IR-codes" RC5_SUPPORT $RC5_SUPPORT
	dep_bool_menu "RC5 IR UDP" RC5_UDP_SUPPORT $RC5_SUPPORT $UDP_SUPPORT $ARCH_AVR
	ip "RC5/LIRC-Server IP address" CONF_RC5_SERVER "192.168.100.3" "2001:4b88:10e4:0:21a:92ff:fe32:53e3"
	if [ "$RC5_UDP_SUPPORT" = "y" ]; then
		choice 'Transmission Value'			\
			"COUNTERS     rc5udpcounters	\
			 COMMANDS     rc5udpcommands"	\
			'COUNTERS' RC5_UDP_SUPPORT_CHOICE
		if [ "$RC5_UDP_SUPPORT_CHOICE" = "rc5udpcounters" ]; then
			define_bool RC5_UDP_SUPPORT_COUNTERS y;
			define_bool RC5_UDP_SUPPORT_COMMANDS n;
		else
			define_bool RC5_UDP_SUPPORT_COUNTERS n;
			define_bool RC5_UDP_SUPPORT_COMMANDS y;
		fi
	fi
	endmenu
	comment  "Debugging Flags"
	dep_bool 'RC5' DEBUG_RC5 $RC5_SUPPORT $DEBUG

endmenu
```

## hardware/lcd/config.in
```kconfig
mainmenu_option next_comment

  comment "LCD Displays"

  comment "Character Displays"

  dep_bool_menu "HD44780 module driver" HD44780_SUPPORT $ARCH_AVR
  if [ "$HD44780_SUPPORT" = "y" ]; then

    # If you add something here, you also have to add an entry in hd44780.h!
    # LCDs can have the same size, but use different start addresses.
    # PLEASE, READ THE DATASHEET!
    choice 'LCD size/type'                                          \
           "8_Characters_1_Line          HD44780_TYPE_8C_1L         \
            16_Characters_1_Line         HD44780_TYPE_16C_1L        \
            16_Characters_1_Line_Mux16   HD44780_TYPE_16C_1L_MUX    \
            20_Characters_1_Line         HD44780_TYPE_20C_1L        \
            40_Characters_1_Line         HD44780_TYPE_40C_1L        \
            8_Characters_2_Lines         HD44780_TYPE_8C_2L         \
            12_Characters_2_Lines        HD44780_TYPE_12C_2L        \
            16_Characters_2_Lines        HD44780_TYPE_16C_2L        \
            20_Characters_2_Lines        HD44780_TYPE_20C_2L        \
            24_Characters_2_Lines        HD44780_TYPE_24C_2L        \
            40_Characters_2_Lines        HD44780_TYPE_40C_2L        \
            16_Characters_4_Lines        HD44780_TYPE_16C_4L        \
            20_Characters_4_Lines        HD44780_TYPE_20C_4L        \
            20_Characters_4_Lines_KS0073 HD44780_TYPE_20C_4L_KS0073 \
            27_Characters_4_Lines_2_EN   HD44780_TYPE_27C_4L        \
            40_Characters_4_Lines_2_EN   HD44780_TYPE_40C_4L"       \
           '16_Characters_2_Lines'       CONF_HD44780_TYPE

	# set MULTIEN for the displays with two controllers
    if [ "$CONF_HD44780_TYPE" = "HD44780_TYPE_27C_4L" -o "$CONF_HD44780_TYPE" = "HD44780_TYPE_40C_4L" ]; then
      define_bool HD44780_MULTIEN_SUPPORT y
    else
      define_bool HD44780_MULTIEN_SUPPORT n
    fi

    choice 'LCD controller type'                                    \
           "HD44780_Compat               HD44780_CONTR_COMPAT       \
            KS0066U                      HD44780_CONTR_KS0066U"     \
           'HD44780_Compat'              CONF_HD44780_CONTROLLER

    choice 'LCD charset conversion'                                 \
           "None                         HD44780_CHARSET_NONE       \
            HD44780_Compat               HD44780_CHARSET_COMPAT"    \
           'None'                        CONF_HD44780_CHARSET

    choice 'Connection type'                                        \
           "Direct                       HD44780_DIREKT             \
            I2C                          HD44780_I2CSUPPORT         \
            SER_LCD(74hct164)            HD44780_SERLCD             \
            2WIRE(74hct4094)             HD44780_2WIRE"             \
           'Direct'                      CONF_HD44780_CONNECTION

	choice 'I2C Port Expander'                                      \
	       "PCF8574                      HD44780_I2C_PCF8574        \
	        MCP23017                     HD44780_I2C_MCP23017"      \
	       'PCF8574'                     CONF_HD44780_I2C_PORTEXP

    if [ "$HD44780_DIREKT" = "y" ]; then
      dep_bool "Readback support" HD44780_READBACK_SUPPORT $HD44780_SUPPORT
    elif [ "$HD44780_I2CSUPPORT" = "y" ]; then
      dep_bool "Readback support" HD44780_READBACK_SUPPORT $HD44780_SUPPORT
      # select dependencies
      define_bool I2C_MASTER_SUPPORT y
      if [ "$HD44780_I2C_PCF8574" = "y" ]; then
        define_bool I2C_PCF8574X_SUPPORT y
      elif [ "$HD44780_I2C_MCP23017" = "y" ]; then
        define_bool I2C_MCP23017_SUPPORT y
      fi
    else
      define_bool HD44780_READBACK_SUPPORT n
    fi

    dep_bool "Backlight support" HD44780_BACKLIGHT_SUPPORT $HD44780_SUPPORT
    dep_bool "Backlight on at power-on" HD44780_BACKLIGHT_POWERON $HD44780_SUPPORT $HD44780_BACKLIGHT_SUPPORT
    dep_bool "Invert Backlight switch" HD44780_BACKLIGHT_INV $HD44780_SUPPORT $HD44780_BACKLIGHT_SUPPORT

    if [ "$HD44780_BACKLIGHT_SUPPORT" = "y" -a "$HD44780_MULTIEN_SUPPORT" = "y" ]; then
      define_bool HD44780_MULTIEN_BACKLIGHT_SUPPORT y
    fi

    if [ "$CONF_HD44780_CHARSET" != "HD44780_CHARSET_NONE" ]; then
      define_bool HD44780_CHARCONV_SUPPORT y
    fi

    comment  "Debugging Flags"
    dep_bool 'HD44780' DEBUG_HD44780 $DEBUG $HD44780_SUPPORT
    dep_bool 'HD44780 Charconv' DEBUG_HD44780_CHARCONV $DEBUG $HD44780_CHARCONV_SUPPORT
    dep_bool 'HD44780 I2C' DEBUG_HD44780_I2C $DEBUG $HD44780_I2CSUPPORT

  fi
  endmenu

  if [ "$TEENSY_SUPPORT" = "y" ]; then
    dep_bool "HR20-style LCD Display without ECMD" HR20_LCD_SUPPORT $atmega169
    comment "Please Define HR20-style LCD Display ECMD Configuration"
  else
    dep_bool "HR20-style LCD Display" HR20_LCD_SUPPORT_FULL $atmega169
  fi

  source hardware/lcd/glcd/config.in

  if [ "$HD44780_SUPPORT" = "y" -o "$GLCD_SUPPORT" = "y" ]; then
    define_bool LCD_SUPPORT y
  else
    define_bool LCD_SUPPORT n
  fi

endmenu
```
