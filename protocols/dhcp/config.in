## protocols/dmx/config.in
```kconfig
usart_count_used
if [ "$DMX_SUPPORT" = y -o $USARTS -gt $USARTS_USED ]; then
	dep_bool_menu "DMX Support" DMX_SUPPORT $DMX_STORAGE_SUPPORT
	int "DMX Output Universe" DMX_OUTPUT_UNIVERSE 1
	choice '  DMX usart select' "$(usart_choice DMX)"
	usart_process_choice DMX
	endmenu
else
	comment "DMX not available. No free usart. ($USARTS_USED/$USARTS)"
	define_bool DMX_SUPPORT n
fi
```

## protocols/ecmd/config.in
```kconfig
dep_bool_menu "ECMD (Ethersex Command) support" ECMD_PARSER_SUPPORT
  dep_bool "Auto remove Backspaces" ECMD_REMOVE_BACKSPACE_SUPPORT $ECMD_PARSER_SUPPORT
  dep_bool_editor "Alias Command Names" ALIASCMD_SUPPORT "protocols/ecmd/alias_defs.m4" $ECMD_PARSER_SUPPORT
  dep_bool "Authentification via PAM (TCP only)" ECMD_PAM_SUPPORT $ECMD_PARSER_SUPPORT $ECMD_TCP_SUPPORT $PAM_SUPPORT
  dep_bool_menu "ECMD Scripting" ECMD_SCRIPT_SUPPORT $VFS_SUPPORT $ECMD_PARSER_SUPPORT
  if [ "$ECMD_SCRIPT_SUPPORT" = y ]; then
    int "  Maximum number of variables" ECMD_SCRIPT_MAX_VARIABLES 4
    int "  Length of variable buffer" ECMD_SCRIPT_VARIABLE_LENGTH 10
    int "  Length of comparator buffer" ECMD_SCRIPT_COMPARATOR_LENGTH 25
    int "  Maximum lines of script" ECMD_SCRIPT_MAXLINES 128
    bool "Script auto start" ECMD_SCRIPT_AUTOSTART_SUPPORT $ECMD_SCRIPT_SUPPORT
    if [ "$ECMD_SCRIPT_AUTOSTART_SUPPORT" = y ]; then
      string "Script name auto start" CONF_ECMD_SCRIPT_AUTOSTART_NAME "auto.es"
    fi
  fi
  endmenu
  comment "ECMD interfaces"
  usart_count_used
  if [ "$ECMD_SERIAL_USART_SUPPORT" = y -o $USARTS -gt $USARTS_USED ]; then
    dep_bool "USART (RS232/RS485)" ECMD_SERIAL_USART_SUPPORT $ECMD_PARSER_SUPPORT
    if [ "$ECMD_SERIAL_USART_SUPPORT" = y ]; then
      choice '  Ecmd usart select' "$(usart_choice ECMD_SERIAL_USART)"
      usart_process_choice ECMD_SERIAL_USART
      dep_bool "  No Echo" ECMD_SERIAL_NO_ECHO $ECMD_SERIAL_USART_SUPPORT
      int "  USART Baudrate" ECMD_SERIAL_BAUDRATE 115200
      int "  USART buffer length" ECMD_SERIAL_USART_BUFFER_LEN 50
      if [ $ECMD_SERIAL_USART_BUFFER_LEN -gt 255 ]; then
        ECMD_SERIAL_USART_BUFFER_LEN=255
      fi
    fi
  else
    comment "USART (RS232/RS485) not available. No free usart. ($USARTS_USED/$USARTS)"
  fi

  dep_bool "TCP/Telnet" ECMD_TCP_SUPPORT $ECMD_PARSER_SUPPORT $TCP_SUPPORT
  if [ "$ECMD_TCP_SUPPORT" = "y" ]; then
    int " TCP Port" ECMD_TCP_PORT 2701
  fi
  dep_bool "UDP" ECMD_UDP_SUPPORT $ECMD_PARSER_SUPPORT $UDP_SUPPORT
  if [ "$ECMD_UDP_SUPPORT" = "y" ]; then
    int " UDP Port" ECMD_UDP_PORT 2701
  fi
  dep_bool "I2C" ECMD_SERIAL_I2C_SUPPORT $ECMD_PARSER_SUPPORT
  if [ "$ECMD_SERIAL_I2C_SUPPORT" = "y" ]; then
    int "    I2C Address" ECMD_I2C_ADDR 8
    int "    I2C Buffer Len" ECMD_I2C_BUFFER_LEN 50
  fi
  dep_bool "USB" ECMD_USB_SUPPORT $ECMD_PARSER_SUPPORT $USB_SUPPORT

  dep_bool "Jabber" ECMD_JABBER_SUPPORT $ECMD_PARSER_SUPPORT $JABBER_SUPPORT
  if [ "$ECMD_JABBER_SUPPORT" = "y" ]; then
    editor "    Edit list of allowed ecmd buddies" JABBER_KNOWN_BUDDIES services/jabber/known_buddies.src
  fi

  dep_bool "IRC" ECMD_IRC_SUPPORT $ECMD_PARSER_SUPPORT $IRC_SUPPORT

  dep_bool "SMS" ECMD_SMS_SUPPORT $ECMD_PARSER_SUPPORT $SMS_SUPPORT
  dep_bool "EEPROM - Read on device eeprom space" ECMD_EEPROM_SUPPORT $ECMD_PARSER_SUPPORT $ARCH_AVR

  comment "Generate ECMD commands"
  dep_bool "  Send via TCP" ECMD_SENDER_SUPPORT $TCP_SUPPORT
  dep_bool "  Send via UDP" UECMD_SENDER_SUPPORT $UDP_SUPPORT

  comment "Optional ECMD commands"
  dep_bool '  Disable IP Config' DISABLE_IPCONF_SUPPORT $UIP_SUPPORT $ECMD_PARSER_SUPPORT
  dep_bool '  Disable Reboot-Commands' DISABLE_REBOOT_SUPPORT $UIP_SUPPORT $ECMD_PARSER_SUPPORT
  dep_bool '  IP Statistics' IPSTATS_SUPPORT $UIP_SUPPORT $ECMD_PARSER_SUPPORT
  dep_bool '  Memory usage information (free)' FREE_SUPPORT $ECMD_PARSER_SUPPORT

  if [ "$TEENSY_SUPPORT" = "y" ] ; then
    dep_bool '  Date ECMD support Only !' CLOCK_DATE_SUPPORT $CLOCK_SUPPORT
    dep_bool '  Time ECMD support Only !' CLOCK_TIME_SUPPORT $CLOCK_SUPPORT
    if [ "$HR20_LCD_SUPPORT" = "y" ] ; then
      dep_bool '  HR20 LCD Display ECMD' HR20_LCD_ECMD_SUPPORT $atmega169
    fi
    if [ "$ADC_LIGHT" = "y" ] ; then
      dep_bool '  HR20 TEMP ECMD' HR20_TEMP_ECMD_SUPPORT $atmega169
    fi
  fi

  comment "Mirror ECMD commands for output"
  dep_bool '  Mirror ECMD commands' ECMD_MIRROR_REQUEST $ECMD_PARSER_SUPPORT
  comment  "Debugging Flags"
  dep_bool 'ECMD' DEBUG_ECMD $DEBUG
  dep_bool 'ECMD FS20' DEBUG_ECMD_FS20 $DEBUG
  dep_bool 'ECMD IP' DEBUG_ECMD_IP $DEBUG
  dep_bool 'ECMD MAC' DEBUG_ECMD_MAC $DEBUG
  dep_bool 'ECMD NET' DEBUG_ECMD_NET $DEBUG
  dep_bool 'ECMD OW LIST' DEBUG_ECMD_OW_LIST $DEBUG
  dep_bool 'ECMD OW ROM' DEBUG_ECMD_OW_ROM $DEBUG
  dep_bool 'ECMD PORTIO' DEBUG_ECMD_PORTIO $DEBUG
  dep_bool 'ECMD RC5' DEBUG_ECMD_RC5 $DEBUG
  dep_bool 'ECMD SCRIPT' DEBUG_ECMD_SCRIPT $DEBUG $ECMD_SCRIPT_SUPPORT

endmenu
```

## protocols/eltakoms/config.in
```kconfig
#
# Copyright (c) 2012 by Frank Sautter <ethersix@sautter.com>
#
# This program is free software; you can redistribute it and/or modify it
# under the terms of the GNU General Public License as published by the Free
# Software Foundation; either version 3 of the License, or (at your option)
# any later version.
#
# This program is distributed in the hope that it will be useful, but WITHOUT
# ANY WARRANTY; without even the implied warranty of MERCHANTABILITY or
# FITNESS FOR A PARTICULAR PURPOSE.  See the GNU General Public License for
# more details.
#
# You should have received a copy of the GNU General Public License along with
# this program; if not, write to the Free Software Foundation, Inc., 675 Mass
# Ave, Cambridge, MA 02139, USA.
#
# For more information on the GPL, please go to:
# http://www.gnu.org/copyleft/gpl.html
#

usart_count_used
if [ "$ELTAKOMS_SUPPORT" = y -o $USARTS -gt $USARTS_USED ]; then
	dep_bool_menu "Eltako MultiSensor (Weather Sensor) support" ELTAKOMS_SUPPORT $ARCH_AVR
		choice '  Eltako USART select' "$(usart_choice ELTAKOMS)"
		usart_process_choice ELTAKOMS
		comment "Debugging Flags"
    dep_bool "Eltako MultiSensor" DEBUG_ELTAKOMS $ELTAKOMS_SUPPORT $DEBUG
	endmenu
else
	define_bool ELTAKOMS_SUPPORT n
	comment "Eltako MultiSensor (Weather Sensor) not available. No free USART. ($USARTS_USED/$USARTS)"
fi
```

## protocols/ems/config.in
```kconfig
usart_count_used
if [ "$EMS_SUPPORT" = y -o $USARTS -gt $USARTS_USED ]; then
	dep_bool_menu "EMS Support" EMS_SUPPORT $TCP_SUPPORT $ARCH_AVR
		if [ "$EMS_BUFFER_LEN" = "" ] ; then
			EMS_BUFFER_LEN=255
		fi
		if [ "$EMS_BUFFER_LEN" -gt "$NET_MAX_FRAME_LENGTH" ] ; then
			EMS_BUFFER_LEN=$NET_MAX_FRAME_LENGTH
		fi
		int    "EMS Buffer Length" EMS_BUFFER_LEN 64
		int    "EMS TCP Port" EMS_PORT 7950
		choice "EMS USART" "$(usart_choice EMS)"
		usart_process_choice EMS
		comment  "Debugging Flags"
		dep_bool 'Statistics ECMD' EMS_DEBUG_STATS $ECMD_PARSER_SUPPORT $EMS_SUPPORT
		dep_bool 'Protocol Debug Output' EMS_PROTO_DEBUG $DEBUG $EMS_SUPPORT
		dep_bool 'I/O Debug Output' EMS_IO_DEBUG $DEBUG $EMS_SUPPORT
		dep_bool 'Error Output' EMS_ERROR_DEBUG $DEBUG $EMS_SUPPORT
	endmenu
else
	comment "EMS not available. No free USART. ($USARTS_USED/$USARTS)"
	define_bool EMS_SUPPORT n
fi
```

## protocols/fnordlicht/config.in
```kconfig
usart_count_used
if [ "$FNORDLICHT_SUPPORT" = y -o $USARTS -gt $USARTS_USED ]; then
	dep_bool_menu "Fnordlicht" FNORDLICHT_BASIC_SUPPORT
		int "soft uart baudrate" FNORDLICHT_BAUDRATE 19200
		choice '  Fnordlicht usart select' "$(usart_choice FNORDLICHT)"
		usart_process_choice FNORDLICHT
		dep_bool_menu "Fnordlicht control" FNORDLICHT_SUPPORT $FNORDLICHT_BASIC_SUPPORT
			int "num lights" CONF_FNORDLICHTER 1
		endmenu
		dep_bool "Fnordlicht servo" FNORDLICHT_SERVO_SUPPORT $PWM_SERVO_SUPPORT $FNORDLICHT_BASIC_SUPPORT
		comment  "Debugging Flags"
		dep_bool 'FNORDLICHT' DEBUG_FNORDLICHT $DEBUG
	endmenu
else
	define_bool FNORDLICHT_SUPPORT n
	comment "Fnordlicht not available. No free usart. ($USARTS_USED/$USARTS)"
fi
```

## protocols/modbus/config.in
```kconfig
usart_count_used
if [ "$MODBUS_SUPPORT" = y -o $USARTS -gt $USARTS_USED ]; then
  dep_bool_menu "Modbus Support" MODBUS_SUPPORT 
    if [ "$MODBUS_SUPPORT" = y ]; then
      choice '  Modbus usart select' "$(usart_choice MODBUS)"
      usart_process_choice MODBUS
      int    "  Modbus usart baudrate" MODBUS_BAUDRATE 9600
      choice '  Modbus usart config'   \
            "8N1            MODBUS_USART_CONFIG_8N1          \
             8E1            MODBUS_USART_CONFIG_8E1" \
            '8E1' MODBUS_USART_CONFIG
    fi
    if [ "$MODBUS_SUPPORT" = y ]; then
      bool "  Modbus Client Stack" MODBUS_CLIENT_SUPPORT  n
    fi
    if [ "$MODBUS_CLIENT_SUPPORT" = y ]; then
      int "  Modbus Client Address" MODBUS_ADDRESS 240
    fi
    if [ "$MODBUS_CLIENT_SUPPORT" = y ]; then
      int "  Modbus Client Broadcast" MODBUS_BROADCAST 255
    fi
  comment "  Remember to customize RS485 direction pin in pinning/hardware"
  endmenu
else
  define_bool MODBUS_SUPPORT n
	comment "MODBUS not available. No free usart. ($USARTS_USED/$USARTS)"
fi
```

## protocols/msr1/config.in
```kconfig
usart_count_used
if [ "$MSR1_SUPPORT" = y -o $USARTS -gt $USARTS_USED ]; then
	dep_bool_menu "Senertec Dachs MSR1 Support" MSR1_SUPPORT $ARCH_AVR
		choice '  MSR1 usart select' "$(usart_choice MSR1)"
		usart_process_choice MSR1
		comment  "Debugging Flags"
		dep_bool 'MSR1' DEBUG_MSR1 $DEBUG
	endmenu
else
	define_bool MSR1_SUPPORT n
	comment "Senertec Dachs MSR1 not available. No free usart. ($USARTS_USED/$USARTS)"
fi
```

## protocols/radio/ask/config.in
```kconfig
if [ "$RFM12_ASK_433_SUPPORT" = "y" -o "$GENERIC_ASK_SUPPORT"  = "y" ]; then
  define_bool RADIO_HW_ASK y
else
  define_bool RADIO_HW_ASK n
fi

dep_bool_menu "Radio outlets (433MHz)" PROTO_ASK_SUPPORT $RADIO_HW_ASK $ARCH_AVR

  choice 'Transmitter hardware' "$(
    if [ "$RFM12_ASK_433_SUPPORT" = "y" ]; then echo -n "RFM12    ASK_HARDWARE_RFM12  "; fi
    if [ "$GENERIC_ASK_SUPPORT"   = "y" ]; then echo -n "Generic  ASK_HARDWARE_GENERIC"; fi
  )" "$(if [ "$RFM12_ASK_433_SUPPORT" = "y" ]; then echo -n "RFM12"; else echo -n "Generic"; fi)" ASK_HARDWARE

  dep_bool "Pollin/Kangtai Powerswitch (IC 2272)" PROTO_2272_SUPPORT $PROTO_ASK_SUPPORT
  dep_bool "Pollin Powerswitch buried (IC 1527)" PROTO_1527_SUPPORT $PROTO_ASK_SUPPORT
  dep_bool "Tevion Powerswitch" PROTO_TEVION_SUPPORT $PROTO_ASK_SUPPORT
  dep_bool "Intertechno ITS-150" PROTO_INTERTECHNO_SUPPORT $PROTO_ASK_SUPPORT
  dep_bool "Intertechno Self Learning" PROTO_INTERTECHNO_SL_SUPPORT $PROTO_ASK_SUPPORT
  dep_bool "Oase FM Master" PROTO_OASEFMMASTER_SUPPORT $PROTO_ASK_SUPPORT
  dep_bool "Flamingo FA20RF/ELRO KD101 " PROTO_FA20RF_SUPPORT $PROTO_ASK_SUPPORT
  if [ "$PROTO_FA20RF_SUPPORT" = "y" ]; then
    define_bool PROTO_SMOKEDETECTOR_SUPPORT y
  else
    define_bool PROTO_SMOKEDETECTOR_SUPPORT n
  fi

endmenu 
```

## protocols/radio/config.in
```kconfig
mainmenu_option next_comment

  comment "Radio"

  source protocols/radio/fs20/config.in
  source protocols/radio/ask/config.in

endmenu
```

## protocols/radio/fs20/config.in
```kconfig
if [ "$RFM12_ASK_868_SUPPORT" = "y" ]; then
  define_bool RADIO_HW_868 y
else
  define_bool RADIO_HW_868 n
fi

dep_bool_menu "FS20 (868MHz)" PROTO_FS20_SUPPORT $RADIO_HW_868 $ARCH_AVR

  choice 'Transmitter/receiver hardware' "$(
    if [ "$RFM12_ASK_868_SUPPORT" = "y" ]; then echo -n "RFM12    FS20_OVER_RFM12  "; fi
#    if [ "$FS20_SUPPORT"          = "y" ]; then echo -n "ELV      FS20_OVER_ELV"; fi
  )" 'RFM12' FS20_HARDWARE

  RFM12_ASK_FS20_SUPPORT=n

  dep_bool "FS20 Send" RFM12_ASK_FS20_TX_SUPPORT $PROTO_FS20_SUPPORT $RFM12_ASK_SUPPORT
  dep_bool "FS20 Receive" RFM12_ASK_FS20_RX_SUPPORT $PROTO_FS20_SUPPORT $RFM12_ASK_SUPPORT
  if [ "$RFM12_ASK_FS20_TX_SUPPORT" = "y" -o "$RFM12_ASK_FS20_RX_SUPPORT" = "y" ]; then
    RFM12_ASK_FS20_SUPPORT=y
  fi
  dep_bool "FHT" RFM12_ASK_FHT_SUPPORT $RFM12_ASK_FS20_SUPPORT $RFM12_ASK_868_SUPPORT $RFM12_ASK_SUPPORT
  dep_bool "ESA" RFM12_ASK_ESA_SUPPORT $RFM12_ASK_FS20_RX_SUPPORT $RFM12_ASK_868_SUPPORT $RFM12_ASK_SUPPORT
  dep_bool "TX3" RFM12_ASK_TX3_SUPPORT $RFM12_ASK_FS20_RX_SUPPORT $RFM12_ASK_868_SUPPORT $RFM12_ASK_SUPPORT
  dep_bool "Send received data via syslog" RFM12_ASK_FS20_SYSLOG $RFM12_ASK_FS20_RX_SUPPORT $RFM12_ASK_868_SUPPORT $RFM12_ASK_SUPPORT $SYSLOG_SUPPORT

  define_bool RFM12_ASK_FS20_SUPPORT "$RFM12_ASK_FS20_SUPPORT"

  comment  "Debugging Flags"
  dep_bool 'FS20' DEBUG_ASK_FS20 $DEBUG $RFM12_ASK_FS20_RX_SUPPORT $RFM12_ASK_868_SUPPORT

endmenu 
```

## protocols/serial_line_log/config.in
```kconfig
usart_count_used
if [ "$SERIAL_LINE_LOG_SUPPORT" = y -o $USARTS -gt $USARTS_USED ]; then
	dep_bool_menu "Serial Line Log Support" SERIAL_LINE_LOG_SUPPORT $ARCH_AVR
		choice '  Serial Line Log usart select' "$(usart_choice SERIAL_LINE_LOG)"
		usart_process_choice SERIAL_LINE_LOG
		int    '  Message timeout (Seconds)' SERIAL_LINE_LOG_TIMEOUT 20
		hex    '  End of Line indicator' SERIAL_LINE_LOG_EOL "0A"
		int    '  Maximal Line Length' SERIAL_LINE_LOG_COUNT 60	 
		int    '  Baudrate' SERIAL_LINE_LOG_BAUDRATE 9600	 
		dep_bool '  Space Compression' SERIAL_LINE_LOG_SPACE_COMPRESSION
#		comment  "Debugging Flags"
#		dep_bool 'SERIAL_LINE_LOG' DEBUG_SERIAL_LINE_LOG $DEBUG $SERIAL_LINE_LOG_SUPPORT
	endmenu
else
	define_bool SERIAL_LINE_LOG_SUPPORT n
	comment "Serial Line Log not available. No free usart. ($USARTS_USED/$USARTS)"
fi
```

## protocols/sgc/config.in
```kconfig
usart_count_used
if [ "$SGC_SUPPORT" = y -o $USARTS -gt $USARTS_USED ]; then
	dep_bool_menu "SGC Support" SGC_SUPPORT $ARCH_AVR
		choice 'SGC usart select' "$(usart_choice SGC)"
		usart_process_choice SGC
		int    "SGC Baudrate" SGC_BAUDRATE 9600
	dep_bool "Preset: Sleep when Shutdown" SGC_SHDN_SLEEP_ACTIVE
	         if [ "$SGC_SLEEPMODE" -gt 1 ] ; then
			      SGC_SLEEPMODE=1
		 fi
                 if [ 0 -gt "$SGC_SLEEPMODE" ] ; then
			      SGC_SLEEPMODE=0
		 fi
			    int    "     Default Sleep Mode (0:Serial 1: Joystick)" SGC_SLEEPMODE 0
	dep_bool "Timeout Counter" SGC_TIMEOUT_COUNTER_SUPPORT
			if [ "$SGC_TIMEOUT_COUNTER_SUPPORT" = "y" ] ; then
		    if [ "$SGC_CONN_TIMEOUT" = "" ] ; then
			    SGC_CONN_TIMEOUT=1
		    fi
		    if [ 1 -gt "$SGC_CONN_TIMEOUT" ] ; then
			    SGC_CONN_TIMEOUT=1
		    fi
		    if [ "$SGC_CONN_TIMEOUT" -gt 255 ] ; then
			    SGC_CONN_TIMEOUT=255
		    fi
		    int    "    Timeout (Min)" SGC_CONN_TIMEOUT 1
		  fi
        dep_bool "Send result via ECMD" SGC_ECMD_SEND_SUPPORT $ECMD_SENDER_SUPPORT
        if [ "$SGC_ECMD_SEND_SUPPORT" = "y" ] ; then
          ip "IP address" SGC_ECMD_IP "192.168.1.1" "2001:6f8:1209:f0:0:0:0:1"
        fi
	endmenu
else
	define_bool SGC_SUPPORT n
	comment "SGC not available. No free usart. ($USARTS_USED/$USARTS)"
fi
```

## protocols/sms77/config.in
```kconfig
dep_bool_menu "SMS77 client" SMS77_SUPPORT $TCP_SUPPORT $DNS_SUPPORT
  string "Server" CONF_SMS77_SERVICE "gateway.sms77.de"
  string "Username" CONF_SMS77_USER ""
  string "Password" CONF_SMS77_PASS ""
  string "Receiver" CONF_SMS77_TO ""

  choice "SMS Type" \
  	"basicplus	CONF_SMS77_TYPE_BASICPLUS \
  	 standard	CONF_SMS77_TYPE_STANDARD \
  	 quality	CONF_SMS77_TYPE_QUALITY \
  	 festnetz	CONF_SMS77_TYPE_FESTNETZ \
  	 flash		CONF_SMS77_TYPE_FLASH" \
  	 basicplus	CONF_SMS77_TYPE_CHOICE

  if [ "$CONF_SMS77_TYPE_BASICPLUS" = "y" ]; then
	define_string CONF_SMS77_TYPE "basicplus"
  fi
  if [ "$CONF_SMS77_TYPE_STANDARD" = "y" ]; then
	define_string CONF_SMS77_TYPE "standard"
  fi
  if [ "$CONF_SMS77_TYPE_QUALITY" = "y" ]; then
	define_string CONF_SMS77_TYPE "quality"
  fi
  if [ "$CONF_SMS77_TYPE_FESTNETZ" = "y" ]; then
	define_string CONF_SMS77_TYPE "festnetz"
  fi
  if [ "$CONF_SMS77_TYPE_FLASH" = "y" ]; then
	define_string CONF_SMS77_TYPE "flash"
  fi

  dep_bool 'Use EEPROM' SMS77_EEPROM_SUPPORT $SMS77_SUPPORT
  comment  "Debugging Flags"
  dep_bool 'SMS77' DEBUG_SMS77 $DEBUG $SMS77_SUPPORT
endmenu
```
