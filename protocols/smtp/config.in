## protocols/to1/config.in
```kconfig
usart_count_used
if [ "$TO1_SUPPORT" = y -o $USARTS -gt $USARTS_USED ]; then
	dep_bool_menu "Tescon TO-1 Support" TO1_SUPPORT $ARCH_AVR
		choice '  TO-1 usart select' "$(usart_choice TO1)"
		usart_process_choice TO1
    int 'TO-1 Sensor Count' TO1_SENSOR_COUNT 1
		comment  "Debugging Flags"
		dep_bool 'TO1' DEBUG_TO1 $DEBUG $TO1_SUPPORT
	endmenu
else
	define_bool TO1_SUPPORT n
	comment "Tescon TO-1 not available. No free usart. ($USARTS_USED/$USARTS)"
fi
```

## protocols/usb/config.in
```kconfig
dep_bool_menu "USB (Softwarestack) Support" USB_SUPPORT $ARCH_AVR

	if [ "$USB_SUPPORT" = "y" ]; then
		dep_bool "device is self powered" USB_CFG_IS_SELF_POWERED $USB_SUPPORT
		dep_bool "auto set USB enable pin" AUTOSET_USB_ENABLE_PIN_SUPPORT $USB_SUPPORT

		if [ "$USB_CFG_IS_SELF_POWERED" = "y" ]; then
			int "USB bus power consumption" USB_CFG_MAX_BUS_POWER 20
		fi
    	choice 'USB Device Type' \
        	"other                     USB_MISC \
	        USBnet                     USB_NET \
    	    HIDkeyboard                USB_KEYBOARD \
    	    HIDmouse                   USB_MOUSE" \
        	'USBnet' USB_DEVICE_CHOICE $USB_SUPPORT
	fi

	if [ "$USB_DEVICE_CHOICE" = "USB_KEYBOARD" ]; then
		define_bool USB_KEYBOARD_SUPPORT y;

    	choice 'Keyboard text' \
        	"sequence                  USB_HID_KEYBOARD_SEQUENCE \
	        static                     USB_HID_KEYBOARD_STATIC \
    	    ECMD                       USB_HID_KEYBOARD_ECMD" \
        	'sequence' USB_HID_KEYBOARD_CHOICE $USB_KEYBOARD_SUPPORT
	else
		define_bool USB_KEYBOARD_SUPPORT n;
	fi
    if [ "$USB_HID_KEYBOARD_CHOICE" = "USB_HID_KEYBOARD_SEQUENCE" ]; then
      define_bool USB_HID_KEYBOARD_SEQUENCE_SUPPORT y;
    else
      define_bool USB_HID_KEYBOARD_SEQUENCE_SUPPORT n;
    fi
	if [ "$USB_HID_KEYBOARD_CHOICE" = "USB_HID_KEYBOARD_STATIC" ]; then
      define_bool USB_HID_KEYBOARD_STATIC_SUPPORT y;
	  string "Write text" USB_HID_KEYBOARD_TEXT "I am your ethersex"
    else
      define_bool USB_HID_KEYBOARD_STATIC_SUPPORT n;
    fi
	if [ "$USB_HID_KEYBOARD_CHOICE" = "USB_HID_KEYBOARD_ECMD" ]; then
      define_bool USB_HID_KEYBOARD_ECMD_SUPPORT y;
    else
      define_bool USB_HID_KEYBOARD_ECMD_SUPPORT n;
    fi

	if [ "$USB_DEVICE_CHOICE" = "USB_MOUSE" ]; then
		define_bool USB_MOUSE_SUPPORT y;
        dep_bool '  auto run sequence' USB_MOUSE_SEQUENCE_SUPPORT $USB_MOUSE_SUPPORT
	else
		define_bool USB_MOUSE_SUPPORT n;
		define_bool USB_MOUSE_SEQUENCE_SUPPORT n;
	fi

	source protocols/usb/usb-net-config.in

	comment  "Debugging Flags"
	dep_bool 'Keyboard Debug' DEBUG_USB_HID_KEYBOARD $DEBUG $USB_KEYBOARD_SUPPORT
	dep_bool 'Mouse Debug' DEBUG_USB_HID_MOUSE $DEBUG $USB_MOUSE_SUPPORT
endmenu
```

## protocols/yport/config.in
```kconfig
usart_count_used
if [ "$YPORT_SUPPORT" = y -o $USARTS -gt $USARTS_USED ]; then
	dep_bool_menu "YPort Support" YPORT_SUPPORT $TCP_SUPPORT $ARCH_AVR
		choice '    YPort usart select' "$(usart_choice YPORT)"
		usart_process_choice YPORT
		int    "YPort TCP Port" YPORT_PORT 7970
		int    "YPort Baudrate" YPORT_BAUDRATE 115200
		
		choice '  YPort usart config'	\
				"8N1      	YPORT_USART_CONFIG_8N1		\
				 8E2		YPORT_USART_CONFIG_8E2"	\
				'8N1' YPORT_USART_CONFIG

		if [ "$YPORT_BUFFER_LEN" = "" ] ; then
			YPORT_BUFFER_LEN=500
		fi
		if [ "$YPORT_BUFFER_LEN" -gt "$NET_MAX_FRAME_LENGTH" ] ; then
			YPORT_BUFFER_LEN=$NET_MAX_FRAME_LENGTH
		fi
		int    "YPort Buffer Length" YPORT_BUFFER_LEN 500
        int    "YPort Max Buffer Flush Interval (N*20ms)" YPORT_FLUSH 25
	comment  "Debugging Flags"
	dep_bool 'YPORT Debug' DEBUG_YPORT $YPORT_SUPPORT
	endmenu
else
	define_bool YPORT_SUPPORT n
	comment "YPORT not available. No free usart. ($USARTS_USED/$USARTS)"
fi
```

## protocols/zbus/config.in
```kconfig
usart_count_used
if [ "$ZBUS_SUPPORT" = y -o $USARTS -gt $USARTS_USED ]; then
	dep_bool_menu "ZBus Support" ZBUS_SUPPORT $ARCH_AVR
	if [ "$ZBUS_SUPPORT" = "y" ]; then
		choice '  ZBus usart select' "$(usart_choice ZBUS)"
		usart_process_choice ZBUS

		int "ZBus Baudrate" CONF_ZBUS_BAUDRATE "19200"

		if [ "$IPV6_SUPPORT" = "y" ]; then
			ipv6 "IP address" CONF_ZBUS_IP "2001:6f8:1209:23:aede:48ff:fe0b:ee52"
			int "IP prefix length" CONF_ZBUS_IP6_PREFIX_LEN 64
		else
			ipv4 "IP address" CONF_ZBUS_IP "192.168.5.1"
			ipv4 "Netmask" CONF_ZBUS_IP4_NETMASK "255.255.255.0"
		fi

		dep_bool "ZBUS ARP-Proxy" ZBUS_ARP_PROXY $ENC28J60_SUPPORT $ZBUS_SUPPORT
		comment  "Debugging Flags"
		dep_bool 'ZBUS ecmd' ZBUS_ECMD $ZBUS_SUPPORT
		dep_bool 'ZBUS Debug' DEBUG_ZBUS $DEBUG
	fi
	endmenu
else
	comment "ZBus Support not available. No free usart. ($USARTS_USED/$USARTS)"
fi
```

## services/clock/config.in
```kconfig
dep_bool_menu "System clock support" CLOCK_SUPPORT

  if [ "$TEENSY_SUPPORT" = "y" ]; then
    comment 'The follow ECMD Options are here and in ECMD Options available'
    bool '  Date ECMD support Only !' CLOCK_DATE_SUPPORT
    bool '  Time ECMD support Only !' CLOCK_TIME_SUPPORT
  else
    dep_bool "Date and Time support" CLOCK_DATETIME_SUPPORT $CLOCK_SUPPORT
  fi

  if [ "$CLOCK_SUPPORT" = "y" ]; then
    mainmenu_option next_comment
      comment "Timezone"
      int "Local time offset to UTC (minutes)" TZ_OFFSET 60
      comment "Daylight saving"
      int "Time offset (minutes)" DST_OFFSET 60
      comment "Begin of daylight saving"
      int "Month (1-12)" DST_BEGIN_MONTH 3
      int "Week (1-5)" DST_BEGIN_WEEK 5
      int "Day of week (0-6)" DST_BEGIN_DOW 0
      int "Hour (0-23)" DST_BEGIN_HOUR 2
      comment "End of daylight saving"
      int "Month (1-12)" DST_END_MONTH 10
      int "Week (1-5)" DST_END_WEEK 5
      int "Day of week (0-6)" DST_END_DOW 0
      int "Hour (0-23)" DST_END_HOUR 3
    endmenu
  fi
  
  if [ "$CLOCK_PERIODIC_SUPPORT" = "y" ]; then
    dep_bool "Use 32 kHz crystal to tick the clock" CLOCK_CRYSTAL_SUPPORT "n"
  else
    dep_bool "Use 32 kHz crystal to tick the clock" CLOCK_CRYSTAL_SUPPORT $CLOCK_SUPPORT
  fi

  if [ "$CLOCK_CRYSTAL_SUPPORT" = "y" ]; then
    dep_bool "Use periodic milliticks to tick the clock" CLOCK_PERIODIC_SUPPORT "n"
  else
    dep_bool "Use periodic milliticks to tick the clock" CLOCK_PERIODIC_SUPPORT $CLOCK_SUPPORT
  fi

  source hardware/clock/dcf77/config.in
  source services/ntp/config.in

  dep_bool "Working hour meter" WHM_SUPPORT $CLOCK_SUPPORT
  dep_bool "Uptime (whm in unix format like: d days, hh:mm)" UPTIME_SUPPORT $CLOCK_SUPPORT

endmenu
```

## services/config.in
```kconfig
mainmenu_option next_comment
comment "Applications"

source services/appsample/config.in
source services/bulbdial/config.in
source services/clock/config.in
source services/cron/config.in
source services/dyndns/config.in
source services/dmx-storage/config.in
source services/dmx-fxslot/config.in
source services/echo/config.in
source services/wol/config.in
source services/motd/config.in
source services/httpd/config.in
source services/jabber/config.in
source services/moodlight/config.in
source services/stella/config.in
source services/starburst/config.in
source services/curtain/config.in
source services/tftp/config.in
source services/upnp/config.in
source services/watchcat/config.in
source services/vnc/config.in
source services/watchasync/config.in
source services/glcdmenu/config.in
source services/lome6/config.in
source services/projectors/sanyoZ700/config.in
source services/freqcount/config.in
source services/tanklevel/config.in
endmenu
```
